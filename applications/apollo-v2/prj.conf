## CMakeLists.txt
```
# SPDX-License-Identifier: Apache-2.0

cmake_minimum_required(VERSION 3.20.0)

find_package(Zephyr REQUIRED HINTS $ENV{ZEPHYR_BASE})
project(apollo_v2)

target_include_directories(app PRIVATE src)

# apps 仓库根 (应用在 apps/applications/<app>/, 公共资产在 apps/fonts)
set(apps_root ${CMAKE_CURRENT_SOURCE_DIR}/../..)

target_sources(app PRIVATE
	src/main.c
	src/board_io.c
	src/app_time.c
	src/shell.c
)

target_sources_ifdef(CONFIG_APOLLO_STORAGE app PRIVATE src/storage.c)
target_sources_ifdef(CONFIG_APOLLO_NET app PRIVATE src/net.c)
target_sources_ifdef(CONFIG_APOLLO_CAN app PRIVATE src/can.c)
target_sources_ifdef(CONFIG_APOLLO_USB app PRIVATE src/usb.c)
target_sources_ifdef(CONFIG_APOLLO_DISPLAY app PRIVATE
	src/display.c
	${apps_root}/fonts/apollo_cjk_16.c
)
target_sources_ifdef(CONFIG_APOLLO_FONT_QSPI app PRIVATE src/font_qspi.c)
# 字体文件用 "lvgl.h" 简单包含
target_compile_definitions_ifdef(CONFIG_APOLLO_DISPLAY app PRIVATE
	LV_LVGL_H_INCLUDE_SIMPLE
)
target_sources_ifdef(CONFIG_APOLLO_WEB app PRIVATE
	src/web.c
	src/ws.c
)

# 内嵌 Web 首页 -> .inc (编译进固件)
if(CONFIG_APOLLO_WEB)
	set(gen_dir ${ZEPHYR_BINARY_DIR}/include/generated)
	generate_inc_file_for_target(app
		${CMAKE_CURRENT_SOURCE_DIR}/src/web/index.html
		${gen_dir}/web_index_html.inc)
	# HTTP 资源描述 iterable section (服务 apollo_web 对应的链接段)
	zephyr_linker_sources(SECTIONS src/web/sections-rom.ld)
endif()

# git 短哈希 -> fw_gitver.h (与 libs 固件升级库共用 gen_gitver.py)
set(gen_dir ${ZEPHYR_BINARY_DIR}/include/generated)
add_custom_command(
	OUTPUT ${gen_dir}/fw_gitver.h
	COMMAND ${PYTHON_EXECUTABLE} ${apps_root}/libs/gen_gitver.py
		${gen_dir}/fw_gitver.h ${apps_root}
	DEPENDS ${apps_root}/libs/gen_gitver.py
	COMMENT "Generating fw_gitver.h"
	VERBATIM
)
add_custom_target(apollo_gitver DEPENDS ${gen_dir}/fw_gitver.h)
add_dependencies(app apollo_gitver)
```

## Kconfig
```
# SPDX-License-Identifier: Apache-2.0
# apollo-v2 应用配置

mainmenu "apollo-v2"

source "Kconfig.zephyr"

menu "apollo-v2 application"

config APOLLO_DISPLAY
	bool "LCD status screen (LVGL + ILI9341 via FMC 8080)"
	default y
	depends on LVGL
	help
	  Status screen on the 2.8" TFTLCD: fw version, uptime, local time,
	  IP address, storage and CAN counters, refreshed once a second.
	  Touch (XPT2046) is wired to the LVGL pointer input.

config APOLLO_WEB
	bool "Web panel (HTTP :80, info + control)"
	default y
	depends on HTTP_SERVER
	help
	  Embedded Chinese dashboard on port 80: device info cards
	  (2s polling), output control buttons, RTC time setting and
	  reboot. REST: /api/info, /api/ctl, /api/time, /api/reboot.

config APOLLO_FONT_QSPI
	bool "Load full CJK font from QSPI partition"
	default y
	depends on APOLLO_DISPLAY
	help
	  On-demand per-glyph reads from the QSPI font partition. Disable
	  to fall back to the linked-in UI-subset font.

config APOLLO_STATUS_PERIOD
	int "Status log period in seconds (0 disables)"
	default 10
	help
	  Period of the periodic status line on the console (uptime, heap,
	  network, storage, CAN counters).

config APOLLO_STORAGE
	bool "Storage bring-up (TF FAT mount with retry, QSPI/SDRAM probe)"
	default y
	select DISK_ACCESS
	help
	  Mounts the TF card (/SD:, FAT) in a background thread with retry,
	  and probes QSPI W25Q256 and FMC SDRAM at boot.

config APOLLO_NET
	bool "Ethernet with DHCP and static fallback"
	default y
	depends on NET_L2_ETHERNET
	help
	  Starts DHCPv4 on the RMII interface; if no lease is obtained
	  within the timeout, falls back to the static address in
	  APOLLO_NET_FALLBACK_ADDR for direct cable use.

config APOLLO_NET_FALLBACK_ADDR
	string "Static fallback IPv4 address"
	default "192.168.12.200"
	depends on APOLLO_NET

config APOLLO_NET_DHCP_TIMEOUT
	int "DHCP timeout in seconds before static fallback"
	default 20
	depends on APOLLO_NET

config APOLLO_NET_STACK_SIZE
	int "Network bring-up thread stack size"
	default 2048
	depends on APOLLO_NET

config APOLLO_NET_PRIORITY
	int "Network bring-up thread priority"
	default 9
	depends on APOLLO_NET

config APOLLO_STORAGE_STACK_SIZE
	int "Storage thread stack size"
	default 4096
	depends on APOLLO_STORAGE

config APOLLO_STORAGE_PRIORITY
	int "Storage thread priority"
	default 10
	depends on APOLLO_STORAGE

config APOLLO_CAN
	bool "FDCAN1 support (CAN variant)"
	default y
	depends on CAN
	help
	  Starts FDCAN1 in normal mode, logs received frames and exposes
	  the 'apollo cansend' shell command. Requires the fdcan1 node to
	  be enabled by the CAN variant overlay (default build).

config APOLLO_CAN_RX_STACK_SIZE
	int "CAN RX thread stack size"
	default 1536
	depends on APOLLO_CAN

config APOLLO_USB
	bool "USB OTG FS CDC ACM (USB variant)"
	default n
	depends on USB_DEVICE_STACK_NEXT
	help
	  Enumerates the OTG FS controller as a CDC ACM device. Requires
	  the usbotg_fs node enabled by the USB variant overlay
	  (usb.overlay + usb.conf, P9 jumper on USB).

config APOLLO_USB_VID
	hex "USB vendor ID"
	default 0x1209
	depends on APOLLO_USB

config APOLLO_USB_PID
	hex "USB product ID"
	default 0xA002
	depends on APOLLO_USB

config APOLLO_USB_MANUFACTURER
	string "USB manufacturer string"
	default "Alientek Apollo V2"
	depends on APOLLO_USB

config APOLLO_USB_PRODUCT
	string "USB product string"
	default "Apollo V2 H743 CDC ACM"
	depends on APOLLO_USB

endmenu
```

## sysbuild.conf
```
# SPDX-License-Identifier: Apache-2.0

SB_CONFIG_BOOTLOADER_MCUBOOT=y

# MCUboot 升级模式: SWAP_SCRATCH (支持试运行/回滚, 与 io-edge-hub 一致;
# V1 实测跨 Flash: slot0 内部 + slot1/scratch QSPI)
SB_CONFIG_MCUBOOT_MODE_SWAP_SCRATCH=y

# 签名密钥 (每个应用独立 RSA-2048)
SB_CONFIG_BOOT_SIGNATURE_KEY_FILE="${APP_DIR}/boards/${BOARD}.pem"
SB_CONFIG_BOOT_SIGNATURE_TYPE_RSA=y
```

## prj.conf
```kconfig
# ==================== 基础 ====================
CONFIG_MAIN_STACK_SIZE=4096
CONFIG_SHELL=y
CONFIG_SHELL_STACK_SIZE=4096
CONFIG_LOG=y
CONFIG_REBOOT=y
CONFIG_THREAD_NAME=y
CONFIG_HEAP_MEM_POOL_SIZE=16384
CONFIG_HWINFO=y

# ==================== 板载 IO ====================
# LED/按键(gpio-leds + gpio-keys, 板 DTS 已含低有效/偏置修复)
CONFIG_GPIO=y
CONFIG_INPUT=y
# ADC1 PA5 / DAC1 PA4 (P10 跳线)
CONFIG_ADC=y
CONFIG_DAC=y
# I2C2: PCF8574(蜂鸣器/网口复位) + 24C02
CONFIG_I2C=y
CONFIG_EEPROM=y
# RTC (LSE)
CONFIG_RTC=y

# ==================== Flash / 外部内存 ====================
# QSPI W25Q256 (仅探测, 不写; 分区/MCUboot 见计划 P1-P2)
CONFIG_FLASH=y
CONFIG_FLASH_STM32_QSPI=y
# FMC SDRAM W9825G6KH (memc 驱动负责控制器初始化)
CONFIG_MEMC=y

# ==================== TF 卡 FAT 文件系统 ====================
CONFIG_DISK_ACCESS=y
CONFIG_DISK_DRIVER_SDMMC=y
CONFIG_FILE_SYSTEM=y
CONFIG_FAT_FILESYSTEM_ELM=y
# 长文件名 + 中文 (V1 修复 #4/#6, 重实现时必须保留)
CONFIG_FS_FATFS_LFN=y
CONFIG_FS_FATFS_LFN_MODE_HEAP=y
CONFIG_FS_FATFS_MAX_LFN=255
CONFIG_FS_FATFS_CODEPAGE=936
CONFIG_FS_FATFS_REENTRANT=y
# 大容量 TF 卡出厂多为 exFAT (实测 16GB 卡挂载 -19 后补开)
CONFIG_FS_FATFS_EXFAT=y

# ==================== QSPI: 字库 + LittleFS 资源区 ====================
# 中文字库上电读入 SDRAM, LVGL 直读 (memmap 方案在本 HAL 上挂死, 见
# font_qspi.c 头注释与 fork 驱动 CONFIG_STM32_MEMMAP_SKIP_INIT_ENTRY 留档)
# /QSPI: 资源区 (Web 静态资源/字库安装暂存)
CONFIG_FILE_SYSTEM_LITTLEFS=y
CONFIG_FS_LITTLEFS_NUM_FILES=4
CONFIG_FS_LITTLEFS_NUM_DIRS=4
CONFIG_FILE_SYSTEM_MKFS=y

# ==================== CAN (节点由变体 overlay 使能) ====================
CONFIG_CAN=y

# ==================== MCUboot + MCUmgr 升级链路 ====================
# 应用链入内部 slot0 (板 DTS code-partition), 由 MCUboot 引导
CONFIG_BOOTLOADER_MCUBOOT=y
# bootutil 库: img_mgmt/flash_img 需要 (提供 boot_write_img_confirmed 等链接符号)
CONFIG_FLASH_MAP=y
CONFIG_MCUBOOT_BOOTUTIL_LIB=y
CONFIG_STREAM_FLASH=y
CONFIG_IMG_MANAGER=y
CONFIG_MCUBOOT_IMG_MANAGER=y
# 升级通道 1/3: MCUmgr SMP over UDP :1337 (计划 §四)
CONFIG_ZCBOR=y
CONFIG_MCUMGR=y
CONFIG_MCUMGR_TRANSPORT_UDP=y
# 默认 1024 对 img 上传+flash 写调用链偏紧
CONFIG_MCUMGR_TRANSPORT_UDP_STACK_SIZE=2048
CONFIG_MCUMGR_GRP_IMG=y
CONFIG_MCUMGR_GRP_OS=y
# fs_mgmt: 字库文件经 SMP 上传到 TF 卡 (apollo fontinstall 再写 QSPI)
CONFIG_MCUMGR_GRP_FS=y
# 字库 ~528KB, 默认 64KB 上限不够 (同时放宽 offset 编码宽度)
CONFIG_MCUMGR_GRP_FS_MAX_FILE_SIZE_4GB=y
CONFIG_NET_SOCKETS=y

# ==================== Web 服务 (信息查看 + 配置) ====================
CONFIG_HTTP_SERVER=y
CONFIG_HTTP_SERVER_VERSION_1=y
CONFIG_HTTP_SERVER_VERSION_2=n
CONFIG_HTTP_SERVER_MAX_CLIENTS=4
CONFIG_HTTP_SERVER_MAX_STREAMS=1
CONFIG_HTTP_SERVER_HUFFMAN_DECODE_BUFFER_SIZE=64
CONFIG_HTTP_SERVER_CLIENT_BUFFER_SIZE=512
CONFIG_HTTP_SERVER_CLIENT_INACTIVITY_TIMEOUT=120
CONFIG_HTTP_SERVER_STACK_SIZE=4096
CONFIG_HTTP_SERVER_MAX_URL_LENGTH=96
CONFIG_HTTP_SERVER_MAX_CONTENT_TYPE_LENGTH=48
# WebSocket: /ws 实时推送 + 固件升级
CONFIG_HTTP_SERVER_WEBSOCKET=y

# ==================== LCD 状态屏 (TFTLCD 2.8" ILI9341, FMC 8080) ====================
# LVGL 9 -> display_ili9341 -> mipi_dbi_stm32_fmc -> FMC NE1 (板 DTS lcd_bank)
CONFIG_DISPLAY=y
CONFIG_ILI9341=y
CONFIG_DISPLAY_LOG_LEVEL_ERR=y
CONFIG_LVGL=y
CONFIG_LV_USE_LABEL=y
CONFIG_LV_FONT_MONTSERRAT_14=y
CONFIG_LV_FONT_MONTSERRAT_16=y
CONFIG_LV_COLOR_DEPTH_16=y
CONFIG_LV_Z_MEM_POOL_SIZE=32768
CONFIG_LV_Z_DOUBLE_VDB=y
# 电阻触摸 XPT2046 (bitbang SPI, zephyr,touch chosen 自动接入 LVGL 指针)
CONFIG_SPI=y
CONFIG_SPI_BITBANG=y
CONFIG_INPUT_XPT2046=y

# ==================== 以太网 (YT8512C RMII) ====================
CONFIG_NETWORKING=y
CONFIG_NET_IPV4=y
CONFIG_NET_IPV6=n
CONFIG_NET_TCP=y
CONFIG_NET_UDP=y
CONFIG_NET_L2_ETHERNET=y
CONFIG_NET_ARP=y
CONFIG_NET_DEFAULT_IF_ETHERNET=y
CONFIG_NET_DHCPV4=y
CONFIG_NET_MGMT=y
CONFIG_NET_MGMT_EVENT=y
CONFIG_NET_MGMT_EVENT_INFO=y
CONFIG_ENTROPY_GENERATOR=y
# 自写 PHY 驱动 (apps/drivers/yt8512)
CONFIG_PHY_MOTORCOMM_YT8512=y
# eth-bwtest 实测: TX 异步模式带负载会卡死, RX 线程栈 2048
CONFIG_ETH_STM32_HAL_RX_THREAD_STACK_SIZE=2048
# 网络缓冲: 整帧 1536B (128B 分片会拖死 TCP), 中等规模池
CONFIG_NET_BUF_DATA_SIZE=1536
CONFIG_NET_BUF_RX_COUNT=40
CONFIG_NET_BUF_TX_COUNT=40
CONFIG_NET_PKT_RX_COUNT=16
CONFIG_NET_PKT_TX_COUNT=16
```

## nofont.conf
```kconfig
# 临时诊断: 禁用 QSPI 字库
CONFIG_APOLLO_FONT_QSPI=n
```

## usb.conf
```kconfig
# apollo-v2 USB 变体附加配置 (与 usb.overlay 一起经
# EXTRA_CONF_FILE / DTC_OVERLAY_FILE 引入, 见 README)

CONFIG_APOLLO_CAN=n
CONFIG_APOLLO_USB=y

# USB device_next (USBD) 栈 + CDC ACM 类
CONFIG_USB_DEVICE_STACK_NEXT=y
CONFIG_USBD_CDC_ACM_CLASS=y
CONFIG_CDC_ACM_SERIAL_INITIALIZE_AT_BOOT=n

CONFIG_USBD_LOG_LEVEL_INF=y
CONFIG_UDC_DRIVER_LOG_LEVEL_WRN=y
CONFIG_USBD_CDC_ACM_LOG_LEVEL_WRN=y
```

## usb.overlay
```dts
/*
 * apollo-v2 USB 变体 (P9 跳线置 USB 侧)
 *
 * 构建时用本文件整体替换默认板级 overlay (不使能 FDCAN1):
 *   west build -b apollo_v2_h743iit6 apps/applications/apollo-v2 \
 *       -DEXTRA_CONF_FILE=usb.conf -DDTC_OVERLAY_FILE=usb.overlay
 * 见 README.md "双变体构建"。
 *
 * 仅接 DM/DP: VBUS 检测脚 PA9 与 USART1_TX (控制台) 冲突, 不用;
 * ID 脚 PA10 仅 host 模式需要, 不用。
 */

/ {
	chosen {
		zephyr_udc0 = &usbotg_fs;
	};
};

&usbotg_fs {
	pinctrl-0 = <&usb_otg_fs_dm_pa11 &usb_otg_fs_dp_pa12>;
	pinctrl-names = "default";
	status = "okay";
};
```

## boards/apollo_v2_h743iit6.overlay
```dts
/*
 * apollo-v2 CAN 变体 (默认构建)
 *
 * P9 跳线置 CAN 侧。USB OTG FS 与 FDCAN1 共用 PA11/PA12, 同一镜像
 * 不可共存 —— USB 变体见 usb.overlay (DTC_OVERLAY_FILE 整体替换本文件)。
 */

&fdcan1 {
	clocks = <&rcc STM32_CLOCK(APB1_2, 8)>,
		 <&rcc STM32_SRC_HSE FDCAN_SEL(0)>;
	pinctrl-0 = <&fdcan1_rx_pa11 &fdcan1_tx_pa12>;
	pinctrl-names = "default";
	bitrate = <500000>;
	sample-point = <875>;	/* per-mille */
	status = "okay";
};

/* PA5 (TPAD/STM_ADC) 悬空时读数飘中值 (~2.5V), 使能下拉后空载读 ~0mV */
&adc1_inp19_pa5 {
	bias-pull-down;
};
```

## src/main.c
```c
/* SPDX-License-Identifier: Apache-2.0
 * apollo-v2 主程序: 板级 IO / RTC / 存储 / 网络 / CAN 各子系统 bring-up
 * + 心跳 LED + 周期状态行。
 *
 * 实现遵循《Apollo_V2_STM32H743_Application_Plan.md》P0 阶段与 §10.2
 * "重新实现时必须保留的修复"。MCUboot/升级链路属 P1-P2, 见 README。
 */

#include <zephyr/kernel.h>
#include <zephyr/logging/log.h>
#include <zephyr/fatal.h>
#include <zephyr/sys/reboot.h>
#ifdef CONFIG_BOOTLOADER_MCUBOOT
#include <zephyr/dfu/mcuboot.h>	/* boot_write_img_confirmed() */
#endif

#include "version.h"
#include "board_io.h"
#include "app_time.h"
#include "storage.h"
#include "net.h"
#include "display.h"
#ifdef CONFIG_APOLLO_CAN
#include "can.h"
#endif
#ifdef CONFIG_APOLLO_USB
void apollo_usb_start(void);
#endif

LOG_MODULE_REGISTER(apollo_main, LOG_LEVEL_INF);

/* 计划 §10.3 教训 #5 的调试加强版: 打印完整 fault 现场 (PC/LR/CFSR/
 * HFSR/BFAR) 后停机不重启 —— 重启会销毁证据; 若复位时无此打印,
 * 则为硬件级复位 (BOR/NRST/看门狗), 与软件 fault 区分开。 */
void k_sys_fatal_error_handler(unsigned int reason, const struct arch_esf *esf)
{
	printk("\n*** FATAL ERROR %u ***\n", reason);
	if (esf != NULL) {
		printk("PC =0x%08lx  LR =0x%08lx  PSR=0x%08lx\n",
		       (unsigned long)esf->basic.pc,
		       (unsigned long)esf->basic.lr,
		       (unsigned long)esf->basic.xpsr);
	}
	volatile uint32_t *cfsr = (volatile uint32_t *)0xE000ED28;
	volatile uint32_t *hfsr = (volatile uint32_t *)0xE000ED2C;
	volatile uint32_t *bfar = (volatile uint32_t *)0xE000ED38;

	printk("CFSR=0x%08lx  HFSR=0x%08lx  BFAR=0x%08lx\n",
	       (unsigned long)*cfsr, (unsigned long)*hfsr, (unsigned long)*bfar);
	printk("system HALTED (debug: 保留现场供 openocd/串口排查)\n");
	for (;;) {
		__asm__ volatile("wfi");
	}
	CODE_UNREACHABLE;
}

/* MCUboot 试运行确认: 上电自检通过并稳定运行 CONFIRM_DELAY 秒后标记
 * slot0 为 confirmed (计划 §三: 不确认 -> 下次复位回滚旧版本)。
 * shell `apollo confirm` 可立即确认; 回滚演练 = 在此之前重启。 */
#ifdef CONFIG_BOOTLOADER_MCUBOOT
#define FW_CONFIRM_DELAY_SEC 30

static bool fw_confirmed;

int apollo_fw_confirm(void)
{
	if (fw_confirmed) {
		return 0;
	}
	int ret = boot_write_img_confirmed();

	if (ret == 0) {
		fw_confirmed = true;
		LOG_INF("image confirmed: 本镜像已标记为正式版");
	} else {
		LOG_WRN("boot_write_img_confirmed: %d (可能本就非 test-pending)", ret);
	}
	return ret;
}
#else
int apollo_fw_confirm(void)
{
	return -ENOTSUP;
}
#endif

static void status_line(void)
{
	const struct apollo_storage_info *si = storage_info();
	const char *ip = net_ip_str();

	LOG_INF("up %us | %s | ip %s | qspi:%s sdram:%s sd:%s%s",
		k_uptime_get_32() / 1000,
		app_time_local_str(),
		ip ? ip : "-",
		si->qspi_ok ? "y" : "n",
		si->sdram_ok ? "y" : "n",
		si->sd_mounted ? "y" : "n",
		net_ip_source() == NET_IP_STATIC_FALLBACK ? " (static)" : "");
#ifdef CONFIG_APOLLO_CAN
	if (can_is_up()) {
		uint32_t rx, tx;

		can_get_stats(&rx, &tx);
		LOG_INF("can rx %u / tx %u", rx, tx);
	}
#endif
}

int main(void)
{
	int64_t utc;

	/* board_io_init 第一步即蜂鸣器静音 (PCF8574 跨复位保持) */
	board_io_init();

	LOG_INF("========================================");
	LOG_INF("apollo-v2 fw %s", APOLLO_FW_VERSION);
	LOG_INF("board apollo_v2_h743iit6, built " __DATE__ " " __TIME__);
	LOG_INF("========================================");

	if (app_time_get_utc(&utc)) {
		LOG_INF("RTC set, local (UTC+8): %s", app_time_local_str());
	} else {
		LOG_WRN("RTC 未设置 (shell: apollo timeset YYYY-MM-DD HH:MM:SS)");
	}

	storage_start();
	net_start();
#ifdef CONFIG_APOLLO_CAN
	apollo_can_start();
#endif
#ifdef CONFIG_APOLLO_USB
	apollo_usb_start();
#endif
#ifdef CONFIG_APOLLO_DISPLAY
	apollo_display_start();
#endif

	LOG_INF("init done");

	uint32_t half_sec = 0;
	uint32_t status_half = 0;

	if (CONFIG_APOLLO_STATUS_PERIOD > 0) {
		status_half = (uint32_t)CONFIG_APOLLO_STATUS_PERIOD * 2;
	}

	for (;;) {
		k_msleep(500);
		half_sec++;

		if (status_half > 0 && (half_sec % status_half) == 0) {
			status_line();
		}
#ifdef CONFIG_BOOTLOADER_MCUBOOT
		if ((half_sec % (FW_CONFIRM_DELAY_SEC * 2)) == 0) {
			apollo_fw_confirm();
		}
#endif
	}

	return 0;
}
```

## src/app_time.c
```c
/* SPDX-License-Identifier: Apache-2.0
 * RTC 时间: 内部存 UTC, 应用层统一 UTC+8 转换 (V1 修复 #10:
 * RTC 直读小时数曾导致显示差 8 小时)。
 */

#include <zephyr/kernel.h>
#include <zephyr/device.h>
#include <zephyr/devicetree.h>
#include <zephyr/drivers/rtc.h>
#include <zephyr/sys/timeutil.h>
#include <zephyr/logging/log.h>
#include <errno.h>
#include <stdio.h>
#include <string.h>

#include "app_time.h"

LOG_MODULE_REGISTER(app_time, LOG_LEVEL_INF);

#define RTC_NODE DT_NODELABEL(rtc)
static const struct device *const rtc_dev = DEVICE_DT_GET(RTC_NODE);

#define LOCAL_UTC_OFFSET_SEC (8 * 3600)	/* UTC+8 */

static void unix_to_rtc_tm(int64_t unix_sec, struct rtc_time *rt)
{
	time_t t = (time_t)unix_sec;
	struct tm tm;

	gmtime_r(&t, &tm);
	memset(rt, 0, sizeof(*rt));
	rt->tm_sec = tm.tm_sec;
	rt->tm_min = tm.tm_min;
	rt->tm_hour = tm.tm_hour;
	rt->tm_mday = tm.tm_mday;
	rt->tm_mon = tm.tm_mon;
	rt->tm_year = tm.tm_year;
	rt->tm_wday = tm.tm_wday;
	rt->tm_yday = tm.tm_yday;
	rt->tm_isdst = 0;
	rt->tm_nsec = 0;
}

static int64_t rtc_tm_to_unix(const struct rtc_time *rt)
{
	struct tm tm;

	memset(&tm, 0, sizeof(tm));
	tm.tm_sec = rt->tm_sec;
	tm.tm_min = rt->tm_min;
	tm.tm_hour = rt->tm_hour;
	tm.tm_mday = rt->tm_mday;
	tm.tm_mon = rt->tm_mon;
	tm.tm_year = rt->tm_year;
	tm.tm_wday = rt->tm_wday;
	tm.tm_yday = rt->tm_yday;
	tm.tm_isdst = 0;
	return (int64_t)timeutil_timegm(&tm);
}

bool app_time_get_utc(int64_t *unix_sec)
{
	struct rtc_time rt;

	if (!device_is_ready(rtc_dev)) {
		return false;
	}
	if (rtc_get_time(rtc_dev, &rt) != 0) {
		return false;
	}
	if (unix_sec != NULL) {
		*unix_sec = rtc_tm_to_unix(&rt);
	}
	/* 掉电后 RTC 从 2000-01-01 起数, 视为未设置 */
	return (rt.tm_year + 1900) >= 2025;
}

int app_time_set_utc(int64_t unix_sec)
{
	struct rtc_time rt;

	if (!device_is_ready(rtc_dev)) {
		return -ENODEV;
	}
	unix_to_rtc_tm(unix_sec, &rt);
	int ret = rtc_set_time(rtc_dev, &rt);

	if (ret == 0) {
		LOG_INF("RTC set: utc=%lld", (long long)unix_sec);
	}
	return ret;
}

bool app_time_get_local(struct tm *tm)
{
	int64_t utc;

	if (!app_time_get_utc(&utc)) {
		return false;
	}
	time_t t = (time_t)(utc + LOCAL_UTC_OFFSET_SEC);

	gmtime_r(&t, tm);
	return true;
}

int app_time_set_local_str(const char *date, const char *time)
{
	struct tm tm;
	int64_t utc;

	memset(&tm, 0, sizeof(tm));
	if (sscanf(date, "%d-%d-%d", &tm.tm_year, &tm.tm_mon, &tm.tm_mday) != 3 ||
	    sscanf(time, "%d:%d:%d", &tm.tm_hour, &tm.tm_min, &tm.tm_sec) != 3) {
		return -EINVAL;
	}
	if (tm.tm_year < 100 || tm.tm_year > 3000 ||
	    tm.tm_mon < 1 || tm.tm_mon > 12 ||
	    tm.tm_mday < 1 || tm.tm_mday > 31) {
		return -EINVAL;
	}
	tm.tm_year -= 1900;
	tm.tm_mon -= 1;

	utc = (int64_t)timeutil_timegm(&tm) - LOCAL_UTC_OFFSET_SEC;
	return app_time_set_utc(utc);
}

const char *app_time_local_str(void)
{
	static char buf[24];
	struct tm tm;

	if (!app_time_get_local(&tm)) {
		return "----.--.-- --:--:--";
	}
	snprintf(buf, sizeof(buf), "%04d-%02d-%02d %02d:%02d:%02d",
		 tm.tm_year + 1900, tm.tm_mon + 1, tm.tm_mday,
		 tm.tm_hour, tm.tm_min, tm.tm_sec);
	return buf;
}
```

## src/app_time.h
```c
/* SPDX-License-Identifier: Apache-2.0 */
#ifndef APOLLO_APP_TIME_H
#define APOLLO_APP_TIME_H

#include <stdbool.h>
#include <stdint.h>
#include <time.h>

/* RTC 时间管理: RTC 存 UTC, 显示/设置走本地 (UTC+8) —— V1 修复 #10 */

/* 读取 RTC 为 UTC Unix 秒; RTC 无效 (年份 < 2025) 返回 false */
bool app_time_get_utc(int64_t *unix_sec);

/* UTC 秒写入 RTC (同时等 LSE 走时) */
int app_time_set_utc(int64_t unix_sec);

/* 本地时间 (UTC+8) 填入 *tm; 返回 false 表示 RTC 未设置 */
bool app_time_get_local(struct tm *tm);

/* 解析 "YYYY-MM-DD HH:MM:SS" 为本地时间并写入 RTC (按 UTC+8 折算) */
int app_time_set_local_str(const char *date, const char *time);

/* 当前本地时间字符串 "YYYY-MM-DD HH:MM:SS" (未设置时返回占位串) */
const char *app_time_local_str(void);

#endif /* APOLLO_APP_TIME_H */
```

## src/board_io.c
```c
/* SPDX-License-Identifier: Apache-2.0
 * 板载基础 IO: LED / 按键 (input 子系统) / 蜂鸣器 (PCF8574) / ADC1 PA5
 *
 * LED/按键极性与偏置已在板 DTS 修正 (低有效 + 上拉, 见应用计划 §10.2)。
 */

#include <zephyr/kernel.h>
#include <zephyr/device.h>
#include <zephyr/devicetree.h>
#include <zephyr/drivers/gpio.h>
#include <zephyr/drivers/adc.h>
#include <zephyr/drivers/i2c.h>
#include <zephyr/input/input.h>
#include <zephyr/logging/log.h>

#include "board_io.h"
#include "version.h"

LOG_MODULE_REGISTER(board_io, LOG_LEVEL_INF);

#define LED0_NODE DT_ALIAS(led0)
#define LED1_NODE DT_ALIAS(led1)

static const struct gpio_dt_spec leds[] = {
	GPIO_DT_SPEC_GET(LED0_NODE, gpios),
	GPIO_DT_SPEC_GET(LED1_NODE, gpios),
};

/* 蜂鸣器: PCF8574 P0, 实测低 = 响。
 * PCF8574 输出状态跨 SWD 复位保持 —— 上电必须第一时间静音。 */
static const struct device *const exio_dev = DEVICE_DT_GET(DT_NODELABEL(exio));

#define BEEP_ON		0	/* P0 raw 低 = 响 */
#define BEEP_OFF	1	/* P0 raw 高 = 停 */

/* ---------------- 按键 (gpio-keys -> input 事件) ---------------- */
static const uint16_t key_codes[] = {
	INPUT_KEY_0,	/* WK_UP PA0 高有效 */
	INPUT_KEY_1,	/* KEY0  PH3 */
	INPUT_KEY_2,	/* KEY1  PH2 */
	INPUT_KEY_3,	/* KEY2  PC13 */
};
BUILD_ASSERT(ARRAY_SIZE(key_codes) == 4);

static uint32_t key_counts[ARRAY_SIZE(key_codes)];
static bool key_down[ARRAY_SIZE(key_codes)];

bool board_io_key_count(unsigned idx, uint32_t *count)
{
	if (idx >= ARRAY_SIZE(key_counts) || count == NULL) {
		return false;
	}
	*count = key_counts[idx];
	return true;
}

/* ---------------- ADC1 PA5 (INP19) ---------------- */
static const struct device *const adc_dev = DEVICE_DT_GET(DT_NODELABEL(adc1));

int board_io_adc_mv(void)
{
	static bool setup_done;
	static struct adc_channel_cfg ch_cfg = {
		.channel_id = 19,		/* PA5 = ADC1_INP19 */
		.gain = ADC_GAIN_1,
		.reference = ADC_REF_INTERNAL,
		.acquisition_time = ADC_ACQ_TIME_DEFAULT,
	};
	uint16_t raw = 0;
	struct adc_sequence seq = {
		.channels = BIT(19),
		.buffer = &raw,
		.buffer_size = sizeof(raw),
		.resolution = 12,
	};
	int32_t mv;
	int ret;

	if (!device_is_ready(adc_dev)) {
		return -ENODEV;
	}
	if (!setup_done) {
		ret = adc_channel_setup(adc_dev, &ch_cfg);
		if (ret != 0) {
			return ret;
		}
		setup_done = true;
	}
	ret = adc_read(adc_dev, &seq);
	if (ret != 0) {
		return ret;
	}
	mv = raw;
	adc_raw_to_millivolts(3300, ADC_GAIN_1, 12, &mv);
	return mv;
}

/* ---------------- LED ---------------- */
int board_io_led_set(unsigned idx, bool on)
{
	if (idx >= ARRAY_SIZE(leds)) {
		return -EINVAL;
	}
	return gpio_pin_set_dt(&leds[idx], on);
}

int board_io_led_toggle(unsigned idx)
{
	if (idx >= ARRAY_SIZE(leds)) {
		return -EINVAL;
	}
	return gpio_pin_toggle_dt(&leds[idx]);
}

/* ---------------- 蜂鸣器 ---------------- */
int board_io_beep(uint16_t ms)
{
	int ret;

	if (!device_is_ready(exio_dev)) {
		return -ENODEV;
	}
	ret = gpio_pin_configure(exio_dev, 0, GPIO_OUTPUT);
	if (ret != 0) {
		return ret;
	}
	gpio_pin_set_raw(exio_dev, 0, BEEP_ON);
	k_msleep(ms);
	gpio_pin_set_raw(exio_dev, 0, BEEP_OFF);
	return 0;
}

int board_io_beeper_set(bool on)
{
	if (!device_is_ready(exio_dev)) {
		return -ENODEV;
	}
	gpio_pin_configure(exio_dev, 0, GPIO_OUTPUT);
	gpio_pin_set_raw(exio_dev, 0, on ? BEEP_ON : BEEP_OFF);
	return 0;
}

/* ---------------- 按键事件回调 ---------------- */
static void key_input_cb(struct input_event *evt, void *user_data)
{
	ARG_UNUSED(user_data);

	if (evt->type != INPUT_EV_KEY) {
		return;
	}
	for (size_t i = 0; i < ARRAY_SIZE(key_codes); i++) {
		if (evt->code == key_codes[i]) {
			key_down[i] = evt->value != 0;
			if (evt->value) {
				key_counts[i]++;
				LOG_INF("KEY%zu pressed (%u)", i, key_counts[i]);
				if (i != 0) {
					/* KEY0/1/2 翻转绿色 LED (输入->输出演示) */
					board_io_led_toggle(1);
				}
			}
			break;
		}
	}
}
INPUT_CALLBACK_DEFINE(NULL, key_input_cb, NULL);

bool board_io_key_is_down(unsigned idx)
{
	return idx < ARRAY_SIZE(key_down) ? key_down[idx] : false;
}

/* ---------------- AP3216C 光照/接近 (I2C2 @0x1E) ---------------- */
#define AP3216C_ADDR		0x1E
#define AP3216C_REG_SYS_CONF	0x00
#define AP3216C_REG_ALS_DL	0x0C
#define AP3216C_REG_ALS_DH	0x0D
#define AP3216C_REG_PS_DL	0x0E
#define AP3216C_REG_PS_DH	0x0F

static const struct device *const als_i2c = DEVICE_DT_GET(DT_NODELABEL(i2c2));
static bool als_enabled;

static int ap3216_write_reg(uint8_t reg, uint8_t val)
{
	uint8_t buf[2] = { reg, val };

	return i2c_write(als_i2c, buf, sizeof(buf), AP3216C_ADDR);
}

static int ap3216_read_reg16(uint8_t reg_lo, uint16_t *val)
{
	uint8_t buf[2];
	int ret = i2c_write(als_i2c, &reg_lo, 1, AP3216C_ADDR);

	if (ret != 0) {
		return ret;
	}
	ret = i2c_read(als_i2c, buf, sizeof(buf), AP3216C_ADDR);
	if (ret != 0) {
		return ret;
	}
	*val = (uint16_t)buf[0] | ((uint16_t)buf[1] << 8);
	return 0;
}

static int ap3216_ensure_enabled(void)
{
	if (als_enabled) {
		return 0;
	}
	if (!device_is_ready(als_i2c)) {
		return -ENODEV;
	}
	/* SYS_CONF = 0x03: ALS + PS 使能 */
	if (ap3216_write_reg(AP3216C_REG_SYS_CONF, 0x03) != 0) {
		return -ENODEV;
	}
	als_enabled = true;
	return 0;
}

int board_io_als_read(uint16_t *als)
{
	uint16_t raw;
	int ret = ap3216_ensure_enabled();

	if (ret != 0) {
		return ret;
	}
	ret = ap3216_read_reg16(AP3216C_REG_ALS_DL, &raw);
	if (ret == 0) {
		/* ALS DH 低 6 位有效, DL 高 4 位有效 -> range 0..0x3FFF */
		*als = (raw >> 4) & 0x3FFF;
	}
	return ret;
}

int board_io_ps_read(uint16_t *ps)
{
	uint16_t raw;
	int ret = ap3216_ensure_enabled();

	if (ret != 0) {
		return ret;
	}
	ret = ap3216_read_reg16(AP3216C_REG_PS_DL, &raw);
	if (ret == 0) {
		/* PS DH 低 2 位 + PS DL -> 10 位 */
		*ps = (raw >> 6) & 0x03FF;
	}
	return ret;
}

int board_io_init(void)
{

	/* PCF8574 状态跨复位保持: 静音必须最先做 (计划 §10.3 教训 #1)。
	 * 注: pcf857x 驱动对首次 GPIO_OUTPUT 配置会误报一条 ERR (驱动
	 * 内部 check 用 value 而非 mask), 但副作用已把引脚标记为输出,
	 * 随后的 set_raw 正常写入 —— hw-bringup 同样用法, 无功能影响 */
	if (device_is_ready(exio_dev)) {
		gpio_pin_configure(exio_dev, 0, GPIO_OUTPUT);
		gpio_pin_set_raw(exio_dev, 0, BEEP_OFF);
	} else {
		LOG_WRN("PCF8574 not ready, beeper unusable");
	}

	for (size_t i = 0; i < ARRAY_SIZE(leds); i++) {
		if (!gpio_is_ready_dt(&leds[i])) {
			LOG_ERR("LED%zu device not ready", i);
			return -ENODEV;
		}
		gpio_pin_configure_dt(&leds[i], GPIO_OUTPUT_INACTIVE);
	}

	/* 依次点亮/熄灭一遍确认极性修复生效 (低有效: active = 亮) */
	board_io_led_set(0, true);
	board_io_led_set(1, true);
	k_msleep(100);
	board_io_led_set(0, false);
	board_io_led_set(1, false);

	LOG_INF("board_io ready (leds/keys/beeper/adc)");
	return 0;
}
```

## src/board_io.h
```c
/* SPDX-License-Identifier: Apache-2.0 */
#ifndef APOLLO_BOARD_IO_H
#define APOLLO_BOARD_IO_H

#include <stdbool.h>
#include <stdint.h>

/* 板载基础 IO 初始化 (LED/按键/蜂鸣器静音/ADC) */
int board_io_init(void);

/* LED: 0 = DS0 红 (PB1), 1 = DS1 绿 (PB0), 均低电平点亮 */
int board_io_led_set(unsigned idx, bool on);
int board_io_led_toggle(unsigned idx);

/* 蜂鸣器 (PCF8574 P0, 低 = 响), 阻塞响 ms 毫秒 */
int board_io_beep(uint16_t ms);

/* 蜂鸣器连续开关 (报警/界面控制用, 不阻塞) */
int board_io_beeper_set(bool on);

/* 按键实时电平 (true = 按下) */
bool board_io_key_is_down(unsigned idx);

/* AP3216C: 光照 (ALS, unit-less data) 与接近 (PS 0-1023)。
 * 返回 0 成功; 传感器不在位返回 -ENODEV */
int board_io_als_read(uint16_t *als);
int board_io_ps_read(uint16_t *ps);

/* ADC1 PA5 (INP19) 单次采样, 返回毫伏值; 负值为错误 */
int board_io_adc_mv(void);

/* 按键累计事件数 (自上电起), 返回 false 表示该键不存在 */
bool board_io_key_count(unsigned idx, uint32_t *count);

#endif /* APOLLO_BOARD_IO_H */
```

## src/can.c
```c
/* SPDX-License-Identifier: Apache-2.0
 * FDCAN1 (PA11/PA12, 500kbit/s): 正常模式, 接收所有标准帧并计数,
 * 前 8 帧逐帧打印, 之后每 100 帧采样打印 (避免总线繁忙时刷屏)。
 */

#include <zephyr/kernel.h>
#include <zephyr/device.h>
#include <zephyr/devicetree.h>
#include <zephyr/drivers/can.h>
#include <zephyr/sys/atomic.h>
#include <zephyr/logging/log.h>
#include <errno.h>
#include <string.h>

#include "can.h"

LOG_MODULE_REGISTER(apollo_can, LOG_LEVEL_INF);

#define CAN_NODE DT_NODELABEL(fdcan1)
static const struct device *const can_dev = DEVICE_DT_GET(CAN_NODE);

CAN_MSGQ_DEFINE(can_rx_msgq, 16);

static struct k_thread rx_thread;
static K_THREAD_STACK_DEFINE(rx_thread_stack, CONFIG_APOLLO_CAN_RX_STACK_SIZE);

static atomic_t rx_count;
static atomic_t tx_count;
static bool can_started;

static void can_rx_thread(void *p1, void *p2, void *p3)
{
	struct can_frame frame;

	ARG_UNUSED(p1);
	ARG_UNUSED(p2);
	ARG_UNUSED(p3);

	for (;;) {
		if (k_msgq_get(&can_rx_msgq, &frame, K_FOREVER) != 0) {
			continue;
		}
		uint32_t n = atomic_inc(&rx_count) + 1;

		if (n <= 8 || (n % 100) == 0) {
			LOG_INF("CAN rx #%u id=0x%03x dlc=%u", n, frame.id, frame.dlc);
		}
	}
}

void apollo_can_start(void)
{
	struct can_filter filter = {
		.id = 0,
		.mask = 0,
		.flags = 0,	/* 所有标准帧 */
	};
	int ret;

	if (!device_is_ready(can_dev)) {
		LOG_WRN("FDCAN1 not ready (本变体未启用 CAN?)");
		return;
	}

	ret = can_start(can_dev);
	if (ret != 0 && ret != -EALREADY) {
		LOG_ERR("FDCAN1 start failed: %d", ret);
		return;
	}
	ret = can_add_rx_filter_msgq(can_dev, &can_rx_msgq, &filter);
	if (ret < 0) {
		LOG_ERR("FDCAN1 add filter failed: %d", ret);
		return;
	}

	k_thread_create(&rx_thread, rx_thread_stack,
			K_THREAD_STACK_SIZEOF(rx_thread_stack),
			can_rx_thread, NULL, NULL, NULL,
			10, 0, K_NO_WAIT);
	k_thread_name_set(&rx_thread, "apollo_can_rx");

	can_started = true;
	LOG_INF("FDCAN1 up @%u kbit/s (normal mode)",
		(unsigned)DT_PROP(CAN_NODE, bitrate) / 1000);
}

int can_send_frame(uint32_t id, const uint8_t *data, size_t len)
{
	struct can_frame frame = {
		.id = id,
		.dlc = len,
		.flags = 0,
	};
	int ret;

	if (!device_is_ready(can_dev)) {
		return -ENODEV;
	}
	if (id > CAN_STD_ID_MASK || len > sizeof(frame.data)) {
		return -EINVAL;
	}
	memcpy(frame.data, data, len);

	ret = can_send(can_dev, &frame, K_MSEC(100), NULL, NULL);
	if (ret == 0) {
		atomic_inc(&tx_count);
	}
	return ret;
}

void can_get_stats(uint32_t *rx, uint32_t *tx)
{
	if (rx != NULL) {
		*rx = atomic_get(&rx_count);
	}
	if (tx != NULL) {
		*tx = atomic_get(&tx_count);
	}
}

bool can_is_up(void)
{
	return can_started;
}
```

## src/can.h
```c
/* SPDX-License-Identifier: Apache-2.0 */
#ifndef APOLLO_CAN_H
#define APOLLO_CAN_H

#include <stdbool.h>
#include <stddef.h>
#include <stdint.h>

/* FDCAN1 (CAN 变体): 正常模式启动 + 收包计数/日志 + 发送接口 */

void apollo_can_start(void);

/* 发送一帧经典 CAN (标准 ID, <=8 字节); 返回 0 成功 */
int can_send_frame(uint32_t id, const uint8_t *data, size_t len);

void can_get_stats(uint32_t *rx, uint32_t *tx);

bool can_is_up(void);

#endif /* APOLLO_CAN_H */
```

## src/display.c
```c
/* SPDX-License-Identifier: Apache-2.0
 * LCD 双页 UI (TFTLCD 2.8" ILI9341 240x320, FMC 8080 16 位):
 *   LVGL 9 -> display_ili9341 -> mipi_dbi_stm32_fmc -> FMC NE1 (板 DTS)
 *
 * 主页: 状态栏(时间/日期/网络/CAN) + 输出卡片(红灯/绿灯/蜂鸣/背光)
 *       + 传感器卡片(电压/光照/接近) + 按键芯片(实时电平) + 文件浏览按钮
 * 文件页: 返回 + 当前路径 + 挂载切换 + 目录列表 (触摸进目录/..返回)
 *
 * 中文: apps/fonts/apollo_cjk_16.c (16px 4bpp, UI 用词 + ASCII, 编译内置;
 * 完整 GB2312 字库走 QSPI 字库分区属后续工作, 见计划 §10.4)
 * 注: 本 fork 的 LVGL port 无自动刷新线程, 应用自跑 lv_timer_handler。
 */

#include <zephyr/kernel.h>
#include <zephyr/device.h>
#include <zephyr/devicetree.h>
#include <zephyr/drivers/display.h>
#include <zephyr/drivers/gpio.h>
#include <zephyr/fs/fs.h>
#include <zephyr/logging/log.h>
#include <lvgl.h>
#include <zephyr/input/input.h>
#include <stdio.h>
#include <string.h>

#include "display.h"
#include "board_io.h"
#include "app_time.h"
#include "storage.h"
#include "net.h"
#include "font_qspi.h"
#ifdef CONFIG_APOLLO_CAN
#include "can.h"
#endif

LOG_MODULE_REGISTER(apollo_display, LOG_LEVEL_INF);

extern const lv_font_t apollo_cjk_16;

/* UI 字体: 优先 QSPI 全量中文字库 (memmap 直读), 未安装回退编译内置的
 * UI 用词字库 (apps/fonts/apollo_cjk_16.c, 文件名生僻字会缺字) */
static const lv_font_t *ui_font(void)
{
#ifdef CONFIG_APOLLO_FONT_QSPI
	return apollo_font_qspi_ready() ? &apollo_font_qspi : &apollo_cjk_16;
#else
	return &apollo_cjk_16;
#endif
}

/* ---------------- 深色主题配色 (设计稿) ---------------- */
#define COL_BG		lv_color_hex(0x0d1420)	/* 页面背景 */
#define COL_CARD	lv_color_hex(0x1a2436)	/* 卡片背景 */
#define COL_CARD_ON	lv_color_hex(0x22304a)	/* 卡片高亮(开启) */
#define COL_BORDER	lv_color_hex(0x2a3850)	/* 边框 */
#define COL_ACCENT	lv_color_hex(0x3b82f6)	/* 主色 */
#define COL_ON		lv_color_hex(0x10b981)	/* 开启状态 */
#define COL_OFF		lv_color_hex(0x5b6b82)	/* 关闭状态 */
#define COL_TEXT	lv_color_hex(0xe8eef7)	/* 主文字 */
#define COL_SUB		lv_color_hex(0x8fa3bd)	/* 次要文字 */

static lv_obj_t *scr_home;
static lv_obj_t *scr_files;

static lv_obj_t *label_time;
static lv_obj_t *label_date;
static lv_obj_t *icon_net;
static lv_obj_t *icon_can;

/* 输出卡片 */
enum output_idx {
	OUT_RED = 0,
	OUT_GREEN,
	OUT_BEEP,
	OUT_BL,
	OUT_COUNT,
};

struct out_card {
	lv_obj_t *obj;
	lv_obj_t *label;	/* 名称 */
	lv_obj_t *state;	/* 开/关 */
	bool on;
};

static struct out_card out_cards[OUT_COUNT];

/* 传感器卡片 */
static lv_obj_t *sens_val[3];
static lv_obj_t *sens_bar[2];	/* 电压/光照带进度条 */

/* 按键芯片 */
static lv_obj_t *key_chips[4];

/* 文件页 */
static lv_obj_t *files_list;
static lv_obj_t *label_path;
static lv_obj_t *label_count;
static lv_obj_t *mnt_btns[2];
static char cur_path[128] = "/SD:";
static const struct device *lcd_dev;
static bool screen_on = true;

/* ---------------- 通用小工具 ---------------- */
static void style_card(lv_obj_t *obj, int32_t w, int32_t h)
{
	lv_obj_set_size(obj, w, h);
	lv_obj_set_style_bg_color(obj, COL_CARD, 0);
	lv_obj_set_style_border_color(obj, COL_BORDER, 0);
	lv_obj_set_style_border_width(obj, 1, 0);
	lv_obj_set_style_radius(obj, 4, 0);
	lv_obj_set_style_pad_all(obj, 0, 0);
}

static lv_obj_t *label_make(lv_obj_t *parent, const char *text,
			    const lv_font_t *font, lv_color_t color)
{
	lv_obj_t *l = lv_label_create(parent);

	lv_label_set_text(l, text);
	if (font != NULL) {
		lv_obj_set_style_text_font(l, font, 0);
	}
	lv_obj_set_style_text_color(l, color, 0);
	return l;
}

/* ---------------- 输出控制 ---------------- */
static void output_apply(unsigned idx, bool on)
{
	switch (idx) {
	case OUT_RED:
		board_io_led_set(0, on);
		break;
	case OUT_GREEN:
		board_io_led_set(1, on);
		break;
	case OUT_BEEP:
		board_io_beeper_set(on);
		break;
	case OUT_BL:
		apollo_display_backlight_set(on);
		break;
	}
	out_cards[idx].on = on;
	lv_obj_set_style_border_color(out_cards[idx].obj,
				      on ? COL_ON : COL_BORDER, 0);
	lv_obj_set_style_bg_color(out_cards[idx].obj,
				  on ? COL_CARD_ON : COL_CARD, 0);
	lv_label_set_text(out_cards[idx].state, on ? "开" : "关");
	lv_obj_set_style_text_color(out_cards[idx].state,
				    on ? COL_ON : COL_OFF, 0);
}

static void out_card_cb(lv_event_t *e)
{
	unsigned idx = (uintptr_t)lv_event_get_user_data(e);

	output_apply(idx, !out_cards[idx].on);
}

/* ---------------- 状态栏 / 传感器 刷新 ---------------- */
static void status_timer_cb(lv_timer_t *t)
{
	ARG_UNUSED(t);
	struct tm tm;
	char buf[24];

	if (app_time_get_local(&tm)) {
		snprintf(buf, sizeof(buf), "%02d:%02d:%02d",
			 tm.tm_hour, tm.tm_min, tm.tm_sec);
		lv_label_set_text(label_time, buf);
		snprintf(buf, sizeof(buf), "%02d/%02d",
			 tm.tm_mon + 1, tm.tm_mday);
		lv_label_set_text(label_date, buf);
	} else {
		lv_label_set_text(label_time, "--:--:--");
		lv_label_set_text(label_date, "--/--");
	}

	/* 网络 / CAN 图标: 绿 = 就绪, 灰 = 离线 */
	lv_obj_set_style_text_color(icon_net,
				    net_ready() ? COL_ON : COL_OFF, 0);
#ifdef CONFIG_APOLLO_CAN
	lv_obj_set_style_text_color(icon_can, can_is_up() ? COL_ON : COL_OFF, 0);
#endif
}

static void sens_timer_cb(lv_timer_t *t)
{
	ARG_UNUSED(t);
	char buf[24];
	int mv = board_io_adc_mv();
	uint16_t als = 0, ps = 0;
	bool als_ok = board_io_als_read(&als) == 0;
	bool ps_ok = board_io_ps_read(&ps) == 0;

	if (mv >= 0) {
		snprintf(buf, sizeof(buf), "%d", mv);
		lv_label_set_text(sens_val[0], buf);
		lv_bar_set_value(sens_bar[0], CLAMP(mv, 0, 3300), LV_ANIM_OFF);
	}
	if (als_ok) {
		snprintf(buf, sizeof(buf), "%u", als);
		lv_label_set_text(sens_val[1], buf);
		lv_bar_set_value(sens_bar[1], CLAMP(als, 0, 3000), LV_ANIM_OFF);
	} else {
		lv_label_set_text(sens_val[1], "--");
	}
	if (ps_ok) {
		snprintf(buf, sizeof(buf), "%u", ps);
		lv_label_set_text(sens_val[2], buf);
	} else {
		lv_label_set_text(sens_val[2], "--");
	}
}

/* WK_UP (INPUT_KEY_0) 按下: 切换屏幕亮灭 (背光 + 面板消隐) */
static void screen_key_cb(struct input_event *evt, void *user_data)
{
	ARG_UNUSED(user_data);

	if (evt->type != INPUT_EV_KEY || evt->code != INPUT_KEY_0 ||
	    evt->value == 0 || lcd_dev == NULL) {
		return;
	}
	screen_on = !screen_on;
	apollo_display_backlight_set(screen_on);
	if (screen_on) {
		display_blanking_off(lcd_dev);
	} else {
		display_blanking_on(lcd_dev);
	}
}
INPUT_CALLBACK_DEFINE(NULL, screen_key_cb, NULL);

static void key_timer_cb(lv_timer_t *t)
{
	ARG_UNUSED(t);

	for (int i = 0; i < 4; i++) {
		lv_obj_set_style_bg_color(key_chips[i],
					  board_io_key_is_down(i) ? COL_ON
								  : COL_CARD,
					  0);
	}
}

/* ---------------- 文件浏览 ---------------- */
static void files_reload(void);

static void back_home_cb(lv_event_t *e)
{
	ARG_UNUSED(e);
	lv_scr_load(scr_home);
}

static void files_btn_cb(lv_event_t *e)
{
	ARG_UNUSED(e);
	files_reload();
	lv_scr_load(scr_files);
}

static void mount_btn_cb(lv_event_t *e)
{
	const char *mnt = lv_event_get_user_data(e);

	strncpy(cur_path, mnt, sizeof(cur_path) - 1);
	cur_path[sizeof(cur_path) - 1] = '\0';
	/* 高亮当前挂载点 */
	for (int i = 0; i < 2; i++) {
		lv_obj_set_style_bg_color(mnt_btns[i],
					  strcmp(cur_path, "/SD:") == 0 ?
					  (i == 0 ? COL_ACCENT : COL_CARD_ON) :
					  (i == 1 ? COL_ACCENT : COL_CARD_ON), 0);
	}
	files_reload();
}

/* 挂载点根路径 ("/SD:" / "/QSPI:") */
static bool is_root_path(const char *p)
{
	return strcmp(p, "/SD:") == 0 || strcmp(p, "/QSPI:") == 0;
}

/* 挂载点是否可用 */
static bool mount_ready(const char *p)
{
	const struct apollo_storage_info *si = storage_info();

	if (strncmp(p, "/SD", 3) == 0) {
		return si->sd_mounted;
	}
	if (strncmp(p, "/QSPI", 5) == 0) {
		return si->qspi_fs_mounted;
	}
	return false;
}

struct dir_entry_info {
	bool is_dir;
	char name[64];
};

static void dir_entry_cb(lv_event_t *e)
{
	const struct dir_entry_info *ent = lv_event_get_user_data(e);

	if (!ent->is_dir) {
		return;
	}
	if (strcmp(ent->name, "..") == 0) {
		/* 去掉最后一级; 保留挂载点 "/SD:" / "/QSPI:" */
		size_t len = strlen(cur_path);

		while (len > 0 && cur_path[len - 1] != '/') {
			len--;
		}
		if (len > 0) {
			len--;
		}
		cur_path[len] = '\0';
		if (strcmp(cur_path, "/SD") == 0) {
			strcpy(cur_path, "/SD:");
		} else if (strcmp(cur_path, "/QSPI") == 0) {
			strcpy(cur_path, "/QSPI:");
		}
	} else {
		size_t len = strlen(cur_path);

		if (len > 0 && cur_path[len - 1] != ':') {
			strncat(cur_path, "/", sizeof(cur_path) - len - 1);
		}
		strncat(cur_path, ent->name,
			sizeof(cur_path) - strlen(cur_path) - 1);
	}
	files_reload();
}

static void files_reload(void)
{
	static struct dir_entry_info entries[40];
	unsigned count = 0;
	struct fs_dir_t dir;
	struct fs_dirent ent;
	char buf[80];

	lv_obj_clean(files_list);
	fs_dir_t_init(&dir);
	lv_label_set_text(label_path, cur_path);

	/* 手动行布局 (本配置未启用 flex, lv_list 会全部堆叠在 (0,0)) */
	static char texts[44][72];
	struct {
		const char *icon;
		struct dir_entry_info *ent;	/* NULL = 提示行 */
	} rows[44];
	unsigned nrow = 0;

	if (!mount_ready(cur_path)) {
		rows[nrow].icon = LV_SYMBOL_CLOSE;
		strncpy(texts[nrow], strncmp(cur_path, "/QSPI", 5) == 0 ?
			"QSPI 未挂载" : "TF 未挂载", sizeof(texts[0]) - 1);
		rows[nrow].ent = NULL;
		nrow++;
		goto fill;
	}

	if (fs_opendir(&dir, cur_path) != 0) {
		rows[nrow].icon = LV_SYMBOL_WARNING;
		strncpy(texts[nrow], "打开目录失败", sizeof(texts[0]) - 1);
		rows[nrow].ent = NULL;
		nrow++;
		goto fill;
	}

	if (!is_root_path(cur_path)) {
		entries[count].is_dir = true;
		strcpy(entries[count].name, "..");
		count++;
	}
	/* 第一遍: 目录; 第二遍: 文件 (目录在前, 与设计稿一致) */
	while (count < 40 && fs_readdir(&dir, &ent) == 0 && ent.name[0] != '\0') {
		if (ent.type == FS_DIR_ENTRY_DIR && strcmp(ent.name, ".") != 0 &&
		    strcmp(ent.name, "..") != 0) {
			entries[count].is_dir = true;
			strncpy(entries[count].name, ent.name,
				sizeof(entries[0].name) - 1);
			entries[count].name[sizeof(entries[0].name) - 1] = '\0';
			count++;
		}
	}
	fs_closedir(&dir);

	fs_dir_t_init(&dir);
	if (fs_opendir(&dir, cur_path) == 0) {
		while (count < 40 && fs_readdir(&dir, &ent) == 0 &&
		       ent.name[0] != '\0') {
			if (ent.type == FS_DIR_ENTRY_FILE) {
				entries[count].is_dir = false;
				strncpy(entries[count].name, ent.name,
					sizeof(entries[0].name) - 1);
				entries[count].name[sizeof(entries[0].name) - 1] = '\0';
				count++;
			}
		}
		fs_closedir(&dir);
	}

	for (unsigned i = 0; i < count; i++) {
		rows[nrow].icon = entries[i].is_dir ? LV_SYMBOL_DIRECTORY
						    : LV_SYMBOL_FILE;
		snprintf(texts[nrow], sizeof(texts[0]), "%s%s", entries[i].name,
			 entries[i].is_dir ? "  <dir>" : "");
		rows[nrow].ent = &entries[i];
		nrow++;
	}

	if (count == 0) {
		rows[nrow].icon = LV_SYMBOL_REFRESH;
		strncpy(texts[nrow], "目录为空", sizeof(texts[0]) - 1);
		rows[nrow].ent = NULL;
		nrow++;
	}

fill:
	for (unsigned i = 0; i < nrow; i++) {
		lv_obj_t *btn = lv_button_create(files_list);

		lv_obj_set_size(btn, 228, 26);
		lv_obj_set_pos(btn, 6, (int32_t)i * 28);
		lv_obj_set_style_bg_color(btn, COL_CARD, 0);
		lv_obj_set_style_radius(btn, 3, 0);
		lv_obj_set_style_pad_all(btn, 0, 0);

		lv_obj_t *ic = label_make(btn, rows[i].icon, NULL, COL_ACCENT);

		lv_obj_set_pos(ic, 6, 5);

		lv_obj_t *lbl = label_make(btn, texts[i], ui_font(), COL_TEXT);

		lv_obj_set_pos(lbl, 26, 4);
		lv_label_set_long_mode(lbl, LV_LABEL_LONG_DOT);
		lv_obj_set_width(lbl, 196);
		lv_obj_set_style_text_align(lbl, LV_TEXT_ALIGN_LEFT, 0);

		if (rows[i].ent != NULL && rows[i].ent->is_dir) {
			lv_obj_add_event_cb(btn, dir_entry_cb, LV_EVENT_CLICKED,
					    rows[i].ent);
		}
	}

	snprintf(buf, sizeof(buf), "%u 项", count);
	lv_label_set_text(label_count, buf);
}

/* ---------------- 构建主页 ---------------- */
static void build_status_bar(lv_obj_t *scr)
{
	lv_obj_t *bar = lv_obj_create(scr);

	lv_obj_set_size(bar, 240, 30);
	lv_obj_set_pos(bar, 0, 0);
	lv_obj_set_style_bg_color(bar, COL_CARD, 0);
	lv_obj_set_style_border_width(bar, 0, 0);
	lv_obj_set_style_radius(bar, 0, 0);
	lv_obj_set_style_pad_all(bar, 0, 0);

	label_time = label_make(bar, "--:--:--", ui_font(), COL_TEXT);
	lv_obj_align(label_time, LV_ALIGN_LEFT_MID, 8, 0);

	label_date = label_make(bar, "--/--", ui_font(), COL_SUB);
	lv_obj_align(label_date, LV_ALIGN_LEFT_MID, 92, 0);

	icon_net = label_make(bar, LV_SYMBOL_WIFI, NULL, COL_OFF);
	lv_obj_align(icon_net, LV_ALIGN_RIGHT_MID, -30, 0);

	icon_can = label_make(bar, LV_SYMBOL_SETTINGS, NULL, COL_OFF);
	lv_obj_align(icon_can, LV_ALIGN_RIGHT_MID, -8, 0);
}

static void build_home(void)
{
	static const char *out_names[OUT_COUNT] = { "红灯", "绿灯", "蜂鸣", "背光" };
	static const lv_point_t out_pos[OUT_COUNT] = {
		{12, 56}, {122, 56}, {12, 92}, {122, 92},
	};

	scr_home = lv_obj_create(NULL);
	lv_obj_set_style_bg_color(scr_home, COL_BG, 0);
	lv_obj_set_scroll_dir(scr_home, LV_DIR_NONE);

	build_status_bar(scr_home);

	lv_obj_t *sec1 = label_make(scr_home, "输 出", ui_font(), COL_SUB);

	lv_obj_set_pos(sec1, 12, 36);

	for (int i = 0; i < OUT_COUNT; i++) {
		struct out_card *c = &out_cards[i];

		c->obj = lv_obj_create(scr_home);
		style_card(c->obj, 110, 30);
		lv_obj_set_pos(c->obj, out_pos[i].x, out_pos[i].y);
		lv_obj_add_flag(c->obj, LV_OBJ_FLAG_CLICKABLE);
		lv_obj_add_event_cb(c->obj, out_card_cb, LV_EVENT_CLICKED,
				    (void *)(uintptr_t)i);

		c->label = label_make(c->obj, out_names[i], ui_font(), COL_TEXT);
		lv_obj_align(c->label, LV_ALIGN_LEFT_MID, 8, 0);

		c->state = label_make(c->obj, "关", ui_font(), COL_OFF);
		lv_obj_align(c->state, LV_ALIGN_RIGHT_MID, -8, 0);
		c->on = false;
	}

	lv_obj_t *sec2 = label_make(scr_home, "传 感", ui_font(), COL_SUB);

	lv_obj_set_pos(sec2, 12, 128);

	static const char *sens_names[3] = { "电压mV", "光照", "接近" };

	for (int i = 0; i < 3; i++) {
		lv_obj_t *card = lv_obj_create(scr_home);

		style_card(card, 72, 54);
		lv_obj_set_pos(card, 8 + i * 75, 148);

		lv_obj_t *name = label_make(card, sens_names[i],
					    ui_font(), COL_SUB);

		lv_obj_set_pos(name, 4, 3);

		sens_val[i] = label_make(card, "--", ui_font(), COL_TEXT);
		lv_obj_set_pos(sens_val[i], 4, 22);

		if (i < 2) {
			sens_bar[i] = lv_bar_create(card);
			lv_obj_set_size(sens_bar[i], 62, 5);
			lv_obj_set_pos(sens_bar[i], 5, 44);
			lv_bar_set_range(sens_bar[i], 0, 100);
			lv_obj_set_style_bg_color(sens_bar[i], COL_BORDER,
						  LV_PART_MAIN);
			lv_obj_set_style_bg_color(sens_bar[i], COL_ACCENT,
						  LV_PART_INDICATOR);
		}
	}

	lv_obj_t *sec3 = label_make(scr_home, "按 键", ui_font(), COL_SUB);

	lv_obj_set_pos(sec3, 12, 208);

	static const char *key_names[4] = { "上键", "键0", "键1", "键2" };

	for (int i = 0; i < 4; i++) {
		key_chips[i] = lv_obj_create(scr_home);
		style_card(key_chips[i], 53, 30);
		lv_obj_set_pos(key_chips[i], 12 + i * 57, 226);

		lv_obj_t *l = label_make(key_chips[i], key_names[i],
					 ui_font(), COL_TEXT);

		lv_obj_center(l);
	}

	lv_obj_t *files_btn = lv_button_create(scr_home);

	lv_obj_set_size(files_btn, 216, 36);
	lv_obj_set_pos(files_btn, 12, 276);
	lv_obj_set_style_bg_color(files_btn, COL_ACCENT, 0);
	lv_obj_add_event_cb(files_btn, files_btn_cb, LV_EVENT_CLICKED, NULL);

	lv_obj_t *fb_label = lv_label_create(files_btn);

	lv_label_set_text(fb_label, LV_SYMBOL_DIRECTORY "  文件浏览");
	lv_obj_set_style_text_font(fb_label, ui_font(), 0);
	lv_obj_center(fb_label);
}

/* ---------------- 构建文件页 ---------------- */
static void build_files(void)
{
	static const char *mnt_names[2] = { "/SD:", "/QSPI:" };

	scr_files = lv_obj_create(NULL);
	lv_obj_set_style_bg_color(scr_files, COL_BG, 0);
	lv_obj_set_scroll_dir(scr_files, LV_DIR_NONE);

	/* 顶栏: 返回 + 路径 + 计数 */
	lv_obj_t *bar = lv_obj_create(scr_files);

	lv_obj_set_size(bar, 240, 30);
	lv_obj_set_pos(bar, 0, 0);
	lv_obj_set_style_bg_color(bar, COL_CARD, 0);
	lv_obj_set_style_border_width(bar, 0, 0);
	lv_obj_set_style_radius(bar, 0, 0);
	lv_obj_set_style_pad_all(bar, 0, 0);

	lv_obj_t *back = lv_button_create(bar);

	lv_obj_set_size(back, 40, 26);
	lv_obj_set_pos(back, 2, 2);
	lv_obj_set_style_bg_color(back, COL_CARD_ON, 0);
	lv_obj_add_event_cb(back, back_home_cb, LV_EVENT_CLICKED, NULL);
	lv_obj_t *bl = lv_label_create(back);

	lv_label_set_text(bl, LV_SYMBOL_LEFT);
	lv_obj_center(bl);

	label_path = label_make(bar, "/SD:", ui_font(), COL_TEXT);
	lv_obj_align(label_path, LV_ALIGN_LEFT_MID, 50, 0);

	label_count = label_make(bar, "", ui_font(), COL_SUB);
	lv_obj_align(label_count, LV_ALIGN_RIGHT_MID, -6, 0);

	/* 挂载点切换 */
	for (int i = 0; i < 2; i++) {
		mnt_btns[i] = lv_button_create(scr_files);

		lv_obj_t *b = mnt_btns[i];

		lv_obj_set_size(b, 108, 26);
		lv_obj_set_pos(b, 12 + i * 112, 34);
		lv_obj_set_style_bg_color(b, i == 0 ? COL_ACCENT : COL_CARD_ON, 0);
		lv_obj_add_event_cb(b, mount_btn_cb, LV_EVENT_CLICKED,
				    (void *)mnt_names[i]);
		lv_obj_t *l = lv_label_create(b);

		lv_label_set_text(l, mnt_names[i]);
		lv_obj_center(l);
	}

	files_list = lv_obj_create(scr_files);
	lv_obj_set_size(files_list, 240, 254);
	lv_obj_set_pos(files_list, 0, 66);
	lv_obj_set_style_bg_color(files_list, COL_BG, 0);
	lv_obj_set_style_border_width(files_list, 0, 0);
	lv_obj_set_style_pad_all(files_list, 0, 0);
	lv_obj_set_scroll_dir(files_list, LV_DIR_VER);
}

/* ---------------- 背光 ---------------- */
static const struct gpio_dt_spec lcd_bl =
	GPIO_DT_SPEC_GET(DT_NODELABEL(lcd_bl), gpios);

int apollo_display_backlight_set(bool on)
{
	if (!gpio_is_ready_dt(&lcd_bl)) {
		return -ENODEV;
	}
	gpio_pin_set_dt(&lcd_bl, on);
	return 0;
}

/* ---------------- 入口 ---------------- */
#define DISPLAY_STACK_SIZE 8192
#define DISPLAY_PRIORITY 5

static K_THREAD_STACK_DEFINE(display_stack, DISPLAY_STACK_SIZE);
static struct k_thread display_thread;

static void display_thread_fn(void *p1, void *p2, void *p3)
{
	ARG_UNUSED(p1);
	ARG_UNUSED(p2);
	ARG_UNUSED(p3);

	const struct device *disp = DEVICE_DT_GET(DT_CHOSEN(zephyr_display));

	lcd_dev = disp;
	/* 等 TF/QSPI 挂载完成: 字库读取不与挂载并发 (并发窗口内读 QSPI 会挂) */
	storage_wait_mounts(K_SECONDS(30));

	if (gpio_is_ready_dt(&lcd_bl)) {
		gpio_pin_configure_dt(&lcd_bl, GPIO_OUTPUT_ACTIVE);
	}

	if (!device_is_ready(disp)) {
		LOG_ERR("display device not ready");
		return;
	}
	display_blanking_off(disp);

	build_home();
	build_files();
	lv_scr_load(scr_home);

	lv_timer_create(status_timer_cb, 1000, NULL);
	lv_timer_create(sens_timer_cb, 500, NULL);
	lv_timer_create(key_timer_cb, 100, NULL);
	status_timer_cb(NULL);
	sens_timer_cb(NULL);

	LOG_INF("LCD UI up (ILI9341 240x320, 主页+文件浏览双页)");

	/* 本 fork 的 LVGL port 无自动刷新线程 */
	for (;;) {
		uint32_t next = lv_timer_handler();

		k_msleep(CLAMP(next, 1U, 20U));
	}
}

int apollo_display_start(void)
{
	k_thread_create(&display_thread, display_stack,
			K_THREAD_STACK_SIZEOF(display_stack),
			display_thread_fn, NULL, NULL, NULL,
			DISPLAY_PRIORITY, 0, K_NO_WAIT);
	k_thread_name_set(&display_thread, "apollo_display");
	return 0;
}
```

## src/display.h
```c
/* SPDX-License-Identifier: Apache-2.0 */
#ifndef APOLLO_DISPLAY_H
#define APOLLO_DISPLAY_H

#include <stdbool.h>

/* 启动 LCD 双页 UI (LVGL + ILI9341/FMC), 生成独立刷新线程 */
int apollo_display_start(void);

/* 背光开关 (PB5, 高 = 亮) */
int apollo_display_backlight_set(bool on);

#endif /* APOLLO_DISPLAY_H */
```

## src/font_qspi.h
```c
/* SPDX-License-Identifier: Apache-2.0 */
#ifndef APOLLO_FONT_QSPI_H
#define APOLLO_FONT_QSPI_H

#include <lvgl.h>
#include <stdbool.h>
#include <stddef.h>
#include <stdint.h>

/* QSPI 字库 (GB2312 一级 + ASCII, 16px 4bpp, AF16 格式)。
 * 数据经 QSPI memory-mapped 区直读, LVGL 回调内二分查码表。 */

/* 字库就绪 (AF16 magic 校验通过); 未安装/校验失败返回 false */
bool apollo_font_qspi_ready(void);

/* QSPI 版全量中文字体 (未就绪时不可用, 用 apollo_font_ui() 兜底) */
extern const lv_font_t apollo_font_qspi;

/* UI 优先字体: QSPI 全量字库, 未安装则回退编译内置的 UI 用词字库 */
const lv_font_t *apollo_font_ui(void);

/* 诊断: 读分区头 16 字节 (hex 字符串输出到 out) */
void apollo_font_dump_header(char *out, size_t outsz);

/* 从 /SD:/font.bin 安装字库到 QSPI font 分区 (校验 AF16 头)。
 * 成功返回 0, 写完后需重启 (清 D-Cache 并让 UI 重新加载)。 */
int apollo_font_install(void);

#endif /* APOLLO_FONT_QSPI_H */
```

## src/net.h
```c
/* SPDX-License-Identifier: Apache-2.0 */
#ifndef APOLLO_NET_H
#define APOLLO_NET_H

#include <stdbool.h>
#include <stddef.h>

/* 以太网 bring-up: DHCP 优先, 超时回退静态 IP (V1 行为) */

/* 当前 IPv4 点分字符串; 无地址时返回 NULL */
const char *net_ip_str(void);

/* 地址来源 */
enum net_ip_source {
	NET_IP_NONE = 0,
	NET_IP_DHCP,
	NET_IP_STATIC_FALLBACK,
};

enum net_ip_source net_ip_source(void);

/* 地址已就绪 (DHCP 租约或静态回退已生效) */
bool net_ready(void);

/* 启动网络线程 */
void net_start(void);

#endif /* APOLLO_NET_H */
```
