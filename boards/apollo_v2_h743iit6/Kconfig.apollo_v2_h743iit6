## boards/apollo_v2_h743iit6/Kconfig.apollo_v2_h743iit6
```kconfig
# SPDX-License-Identifier: Apache-2.0

config BOARD_APOLLO_V2_H743IIT6
	bool "Alientek Apollo V2 STM32H743IIT6 Board"
	select SOC_STM32H743XX
```

## boards/apollo_v2_h743iit6/apollo_v2_h743iit6_defconfig
```kconfig
# SPDX-License-Identifier: Apache-2.0

# Cortex-M7 MPU: 启用硬件栈溢出保护
CONFIG_ARM_MPU=y
CONFIG_HW_STACK_PROTECTION=y

# UART + 控制台
CONFIG_SERIAL=y
CONFIG_CONSOLE=y
CONFIG_UART_CONSOLE=y

# GPIO
CONFIG_GPIO=y
```

## boards/apollo_v2_h743iit6/board.yml
```yaml
board:
  name: apollo_v2_h743iit6
  full_name: Alientek Apollo V2 STM32H743IIT6
  vendor: st
  socs:
    - name: stm32h743xx
```

## boards/gd32h759_btb/Kconfig.gd32h759_btb
```kconfig
# SPDX-License-Identifier: Apache-2.0

config BOARD_GD32H759_BTB
	bool "EmbedFire GD32H759IMK6 BTB Board"
	select SOC_GD32H759
```

## boards/gd32h759_btb/board.yml
```yaml
board:
  name: gd32h759_btb
  full_name: EmbedFire GD32H759IMK6 BTB Board
  vendor: gd
  socs:
    - name: gd32h759
```

## boards/io_edge_f407vet6/Kconfig.io_edge_f407vet6
```kconfig
# SPDX-License-Identifier: Apache-2.0

config BOARD_IO_EDGE_F407VET6
	bool "IO Edge F407VET6 Board"
	select SOC_STM32F407XE
```

## boards/io_edge_f407vet6/board.yml
```yaml
board:
  name: io_edge_f407vet6
  full_name: LCKFB STM32F407VET6 IO Edge Board
  vendor: st
  socs:
    - name: stm32f407xx
```

## boards/io_edge_f407vet6/io_edge_f407vet6_defconfig
```kconfig
# SPDX-License-Identifier: Apache-2.0

# Cortex-M4 有 MPU: 启用硬件栈溢出保护
CONFIG_ARM_MPU=y
CONFIG_HW_STACK_PROTECTION=y

# UART + 控制台
CONFIG_SERIAL=y
CONFIG_CONSOLE=y
CONFIG_UART_CONSOLE=y

# GPIO
CONFIG_GPIO=y

# Flash + Flash Map (MCUboot)
CONFIG_FLASH=y
CONFIG_FLASH_MAP=y
CONFIG_SPI_NOR_SFDP_MINIMAL=n
CONFIG_SPI_NOR_FLASH_LAYOUT_PAGE_SIZE=4096
```

## boards/titan_mini/Kconfig.titan_mini
```kconfig
# SPDX-License-Identifier: Apache-2.0

config BOARD_TITAN_MINI
	bool "RT-Thread Titan Mini (RA8P1)"
	select SOC_R7KA8P1KFLCAC_CM85 if BOARD_TITAN_MINI_R7KA8P1KFLCAC_CM85
	select SOC_R7KA8P1KFLCAC_CM33 if BOARD_TITAN_MINI_R7KA8P1KFLCAC_CM33
```

## boards/titan_mini/board.yml
```yaml
board:
  name: titan_mini
  full_name: RT-Thread Titan Mini (Renesas RA8P1)
  vendor: renesas
  socs:
    - name: r7ka8p1kflcac
```

## drivers/nrf24l01p/Kconfig
```kconfig
# Nordic nRF24L01+ radio driver configuration options

config NRF24L01P
	bool "Nordic nRF24L01+ 2.4GHz radio driver"
	default n
	depends on SPI
	help
	  Enable driver for the Nordic nRF24L01+ 2.4GHz transceiver
	  (SPI bus + GPIO interrupt).

config NRF24L01P_INIT_PRIORITY
	int "Init priority"
	default 70
	depends on NRF24L01P
	help
	  nRF24L01P device initialization priority. Must run after the
	  SPI and GPIO controllers (within POST_KERNEL).

config NRF24L01P_POWER_ON_DELAY_MS
	int "Power-on stabilization delay (ms)"
	default 100
	depends on NRF24L01P
	help
	  Delay after asserting the power-gpios before any SPI access, to let
	  the chip complete Power-On-Reset. Only used when the devicetree node
	  has a power-gpios property.

config NRF24L01P_LOG_LEVEL
	int "Log level"
	default 3
	depends on NRF24L01P && LOG
	help
	  0=none 1=err 2=wrn 3=inf 4=dbg.

config NRF24L01P_INT_THREAD_STACK_SIZE
	int "Stack size for interrupt handler"
	default 512
	depends on NRF24L01P
	help
	  Stack size of the internal thread that drains the RX FIFO and
	  processes TX completion events on IRQ.

config NRF24L01P_INT_THREAD_PRIORITY
	int "Priority of interrupt handler thread"
	default 2
	depends on NRF24L01P
	help
	  Priority of the internal bottom-half thread (cooperative thread;
	  lower value means higher priority).

config NRF24L01P_CRYPT
	bool "Enable XXTEA-CTR link-layer encryption"
	default n
	depends on NRF24L01P
	help
	  XXTEA-CTR stream cipher using the 5-byte rf24 address as key.
	  Encrypts the full frame (CAN-ID header + payload) with zero length
	  expansion except a 1-byte counter prefix (payload 30B -> 29B).

	  Must be enabled on BOTH endpoints (mod_handler + gateway).
	  Mismatched configuration results in one-way silent frame drops
	  (decrypt fails, frames discarded without crashing).

	  When disabled, the link operates exactly as before (plaintext).
```

## drivers/w5500_toe/Kconfig
```kconfig
# W5500 hardware TCP/IP offload (TOE) socket driver

config W5500_TOE
	bool "W5500 hardware TCP/IP offload (TOE) socket driver"
	depends on DT_HAS_WIZNET_W5500_TOE_ENABLED
	depends on SPI
	depends on !ETH_W5500
	depends on NET_SOCKETS
	select NET_SOCKETS_OFFLOAD
	select NET_SOCKETS_OFFLOAD_DISPATCHER
	help
	  Drive the W5500 with its on-chip TCP/IP engine (8 hardware
	  sockets, ARP/ICMP/TCP/UDP in silicon) through the socket
	  offload API, bypassing the native Zephyr IP stack entirely.

	  Mutually exclusive with the in-tree MACRAW driver
	  (ETH_W5500): both bind the same chip, one via the
	  "wiznet,w5500" compatible (MACRAW + native stack), the other
	  via "wiznet,w5500-toe" (hardware stack). Only one of the two
	  can be enabled in a build.

	  Limitations: IPv4 only, no TLS, 8 sockets total, static IP
	  from devicetree (local-ip/netmask/gateway) or Kconfig
	  defaults.

config W5500_TOE_INIT_PRIORITY
	int "Init priority"
	default 70
	depends on W5500_TOE
	help
	  Device init priority. Must run after the SPI and GPIO
	  controllers (POST_KERNEL).

config W5500_TOE_POLL_PERIOD_MS
	int "Socket readiness poll period (ms)"
	default 4
	depends on W5500_TOE
	help
	  Period of the delayed-work notifier that raises poll signals
	  and wakes blocked socket operations. Blocking operations are
	  correct regardless of this value (bounded slice re-checks);
	  it only affects wakeup latency and poll() responsiveness.

config W5500_TOE_LOG_LEVEL
	int "Log level"
	default 3
	depends on W5500_TOE
	help
	  0=none 1=err 2=wrn 3=inf 4=dbg.
```

## drivers/yt8512/Kconfig
```kconfig
# Motorcomm YT8512 Ethernet PHY

config PHY_MOTORCOMM_YT8512
	bool "Motorcomm YT8512 Ethernet PHY driver"
	default y
	depends on DT_HAS_MOTORCOMM_YT8512_ENABLED
	depends on ETH_STM32_HAL
	select MDIO
	help
	  Motorcomm YT8512/YT8512C 10/100 Ethernet PHY driver, ported from
	  the upstream phy_motorcomm_yt8521.c (same MII register layout,
	  specific status register 0x11).

	  The PHY ID check accepts MII register 0x03 Type_No 0x12 (YT8512
	  family); the YT8521-specific extended registers (0xA000 space
	  select / RGMII delay / SYNCE) are not touched. reset-gpios is
	  supported (the Apollo V2 board routes PHY reset through a PCF8574
	  I2C IO expander).

	  Depends on ETH_STM32_HAL: 无网络配置的应用 (MDIO 控制器不编译)
	  不应拉入本驱动, 否则链接失败 (mdio 设备符号未定义)。
```

## dts/bindings/ethernet/phy/motorcomm,yt8512.yaml
```yaml
# SPDX-FileCopyrightText: Copyright The Zephyr Project Contributors
# SPDX-License-Identifier: Apache-2.0

description: Motorcomm YT8512 10/100 Ethernet PHY

compatible: "motorcomm,yt8512"

include:
  - name: ethernet-phy-common.yaml
  - name: ethernet-phy-reset-gpios.yaml

properties:
  default-speeds:
    default: ["10BASE Half-Duplex", "10BASE Full-Duplex",
              "100BASE Half-Duplex", "100BASE Full-Duplex"]
```

## dts/bindings/net/wiznet,w5500-toe.yaml
```yaml
# Copyright (c) 2026
# SPDX-License-Identifier: Apache-2.0

description: |
  Wiznet W5500 Ethernet controller driven in hardware TCP/IP offload (TOE)
  mode: the chip's 8 hardware sockets run ARP/ICMP/TCP/UDP in silicon and
  are exposed through Zephyr's socket offload API (native IP stack unused).

  Mutually exclusive with the in-tree MACRAW driver ("wiznet,w5500" in
  zephyr/drivers/ethernet/eth_w5500.c): a board picks exactly one compatible
  for its W5500 node, and Kconfig (W5500_TOE depends on !ETH_W5500) keeps
  the two drivers from being enabled together.

compatible: "wiznet,w5500-toe"

include: [spi-device.yaml]

properties:
  reset-gpios:
    type: phandle-array
    required: false
    description: |
      Reset pin (active low). When absent the chip is soft-reset through
      the MR register instead.
  int-gpios:
    type: phandle-array
    required: false
    description: |
      INTn pin (active low). When wired, socket events (connect, data,
      disconnect, timeout) drive readiness through interrupts with no
      periodic polling; when absent the driver falls back to a delayed-
      work poll (CONFIG_W5500_TOE_POLL_PERIOD_MS).
  local-mac-address:
    type: uint8-array
    required: false
    description: |
      6-byte MAC address. When absent the driver generates one from the
      Wiznet OUI (00:08:DC) plus random node bytes.
  local-ip:
    type: string
    required: false
    description: |
      Static IPv4 address programmed into the chip (SIPR). Defaults to
      CONFIG_W5500_TOE_DEFAULT_IP.
  netmask:
    type: string
    required: false
    description: |
      Subnet mask programmed into the chip (SUBR). Defaults to
      CONFIG_W5500_TOE_DEFAULT_NETMASK.
  gateway:
    type: string
    required: false
    description: |
      Gateway programmed into the chip (GAR). Defaults to
      CONFIG_W5500_TOE_DEFAULT_GATEWAY.
```

## libs/can_fw_upgrade/Kconfig
```kconfig
# SPDX-License-Identifier: Apache-2.0

config CAN_FW_UPGRADE
	bool "CAN firmware upgrade support"
	default n
	depends on FLASH && IMG_MANAGER
	help
	  Enable CAN-based firmware upgrade functionality.
	  The library is self-contained: it initializes the CAN controller,
	  owns the RX thread, handles firmware-upgrade frames (0x101/0x103)
	  internally, and forwards all other frames to an application-
	  registered callback. Apps only call can_fw_init() once and register
	  a business-frame callback.

config CAN_FW_UPGRADE_RX_STACK_SIZE
	int "CAN FW upgrade RX thread stack size"
	default 1024
	depends on CAN_FW_UPGRADE

config CAN_FW_UPGRADE_RX_PRIORITY
	int "CAN FW upgrade RX thread priority"
	default 8
	depends on CAN_FW_UPGRADE

config CAN_FW_UPGRADE_INIT_PRIORITY
	int "CAN FW upgrade init priority"
	default 70
	depends on CAN_FW_UPGRADE
	help
	  SYS_INIT priority for CAN controller setup (bitrate/start/filter).
	  Runs at APPLICATION level, after the CAN driver is up.

config CAN_FW_UPGRADE_BITRATE
	int "CAN FW upgrade bus bitrate (bps)"
	default 250000
	depends on CAN_FW_UPGRADE
	help
	  CAN bus bitrate the library uses when initializing the controller.

config CAN_FW_UPGRADE_MAX_HANDLERS
	int "Max number of app frame handlers"
	default 4
	depends on CAN_FW_UPGRADE
	help
	  Capacity of the business-frame callback array. Each registered
	  callback receives every non-upgrade CAN frame (broadcast).

# BOOT_GO_HOOKS 仅存在于 MCUboot 构建, can_fw_boot.c 因此只编入 bootloader。
config CAN_FW_UPGRADE_BOOT_WAIT
	bool "Wait for CAN firmware upgrade inside MCUboot"
	default y
	depends on CAN_FW_UPGRADE && BOOT_GO_HOOKS
	help
	  Compile the MCUboot boot_go_hook (can_fw_boot.c): probe the host
	  over CAN at bootloader startup, wait for a firmware transfer if
	  the host responds, and let boot_go swap in the same session after
	  CONFIRM. The upgrade protocol handling is shared with the
	  application build (same sources).

if CAN_FW_UPGRADE_BOOT_WAIT

config CAN_FW_UPGRADE_PROBE_TIMEOUT_MS
	int "Boot probe window (ms)"
	default 500
	help
	  Window during which probe frames (0x106) are re-sent while
	  awaiting the host response (0x107); expires into normal boot.

config CAN_FW_UPGRADE_IDLE_TIMEOUT_MS
	int "Firmware idle timeout in bootloader wait (ms)"
	default 15000
	help
	  After the host acknowledges the probe, wait this long for
	  upgrade frames (0x101/0x103/0x104), refreshed by each frame,
	  before continuing normal boot.

endif
```

## libs/udp_fw_upgrade/Kconfig
```kconfig
# SPDX-License-Identifier: Apache-2.0

config UDP_FW_UPGRADE
	bool "UDP firmware upgrade support"
	default n
	depends on NET_SOCKETS && FLASH && IMG_MANAGER && NET_MGMT_EVENT
	help
	  Enable UDP-based firmware upgrade functionality.
	  The library is self-contained: it creates the config-port UDP
	  socket (binds INADDR_ANY:CONFIG_UDP_FW_CONFIG_PORT), owns the RX
	  thread, handles firmware-upgrade commands (FW_START 0x1 /
	  FW_DATA 0x2 / FW_END 0x3 / GET_VERSION 0x4 / REBOOT 0x5)
	  internally, and forwards all other config commands to
	  an application-registered callback. Apps only register a
	  business-command callback and never touch the config socket.

config UDP_FW_CONFIG_PORT
	int "UDP config port (firmware upgrade + app commands)"
	default 8600
	depends on UDP_FW_UPGRADE
	help
	  UDP port the library binds to for receiving config commands
	  and firmware upgrade requests.

config UDP_FW_DATA_V2_CHUNK
	int "FW_DATA_V2 max chunk size"
	range 512 1400
	default 1024
	depends on UDP_FW_UPGRADE
	help
	  Maximum data payload of one FW_DATA_V2 (0x06) frame. The value
	  is announced to the host in the extended FW_START reply so both
	  sides agree on the frame size (old hosts ignore the extra
	  bytes and keep using legacy 511B FW_DATA frames). Upper bound
	  1400 keeps the frame inside one Ethernet MTU; boards with
	  small CONFIG_NET_BUF_DATA_SIZE (many small fragments per
	  frame) should keep this modest.

config UDP_FW_RX_STACK_SIZE
	int "UDP FW upgrade RX thread stack size"
	default 1024
	depends on UDP_FW_UPGRADE

config UDP_FW_RX_PRIORITY
	int "UDP FW upgrade RX thread priority"
	default 8
	depends on UDP_FW_UPGRADE

config UDP_FW_INIT_PRIORITY
	int "UDP FW upgrade init priority"
	default 90
	depends on UDP_FW_UPGRADE
	help
	  SYS_INIT priority. Must run after networking is up
	  (NET_L2/NET_MGMT level). The library waits for NET_EVENT_IF_UP
	  internally before binding the socket.

config UDP_FW_UPGRADE_MAX_HANDLERS
	int "Max number of app command handlers"
	default 4
	depends on UDP_FW_UPGRADE
	help
	  Capacity of the business-command callback array. Each registered
	  callback receives every non-firmware-upgrade command (broadcast).

config UDP_FW_UPGRADE_MAX_BCAST_CMDS
	int "Max commands allowed to broadcast-reply"
	default 8
	depends on UDP_FW_UPGRADE && UDP_FW_REPLY_BCAST_RESTRICT
	help
	  Capacity of the broadcast-reply allowlist. Only commands registered
	  via udp_fw_allow_broadcast_cmd() get a cross-subnet broadcast reply;
	  all others are silently dropped when received cross-subnet.

config UDP_FW_REPLY_BCAST_RESTRICT
	bool "Restrict cross-subnet broadcast replies to allowed commands"
	default y
	depends on UDP_FW_UPGRADE
	help
	  When enabled, cross-subnet (broadcast) replies on the config port are
	  only sent for commands registered via udp_fw_allow_broadcast_cmd();
	  all other commands received cross-subnet are silently dropped. This
	  prevents a broadcast reply from flooding every device on the subnet
	  for non-discovery commands (e.g. RF24/network/firmware config).
	  Disable to restore the legacy behavior where any command received
	  cross-subnet is answered with an unrestricted broadcast reply.
```

## west.yml
```yaml
# The west manifest file for Zephyr project.
#

manifest:
  defaults:
    remote: zephyr

  remotes:
    - name: zephyr
      url-base: https://github.com/zephyrproject-rtos

  projects:
    - name: zephyr
      revision: v4.4.2
      path: zephyr
      import:
        name-allowlist:
          - cmsis_6
          - hal_stm32
          - littlefs
          - mbedtls
          - mcuboot
          - tf-psa-crypto
          - zcbor

  self:
    path: apps
    west-commands: scripts/west-commands.yml
```
