## CMakeLists.txt
```
# SPDX-License-Identifier: Apache-2.0

cmake_minimum_required(VERSION 3.20.0)

find_package(Zephyr REQUIRED HINTS $ENV{ZEPHYR_BASE})
project(j1939_demo)

target_include_directories(app PRIVATE src)

target_sources(app PRIVATE
	src/main.c
	src/j1939.c
	src/j1939_tp.c
)
```

## Kconfig
```
# SPDX-License-Identifier: Apache-2.0
# j1939-demo application configuration

mainmenu "j1939-demo"

source "Kconfig.zephyr"

config J1939_DEMO_PREFERRED_ADDRESS
	int "Preferred source address (SA)"
	range 0 253
	default 128
	help
	  J1939/81 首选源地址。0~253 中部分地址有行业约定
	  (如 0=发动机 #1、3=变速箱 #1、40=仪表簇 #1),
	  演示节点使用自由地址避免与真实 ECU 冲突。

config J1939_DEMO_TX_PERIOD_MS
	int "IO status broadcast period (ms)"
	range 20 60000
	default 1000

config J1939_DEMO_BAM_EVERY_N
	int "Send BAM extended status every N basic frames"
	range 1 10000
	default 5
	help
	  每发送 N 帧单帧 IO 状态 (PGN 65280) 后, 额外用
	  J1939 TP BAM 发送一帧 16 字节扩展状态 (PGN 65281),
	  演示 J1939/21 多包传输。
```

## prj.conf
```kconfig
# SPDX-License-Identifier: Apache-2.0
# j1939-demo: Zephyr + 自带极简 J1939 协议栈 (无第三方栈)
#
# 板级 DTS (io_edge_f407vet6) 已将 can1 配置为 250 kbps
# (恰好是 J1939/11 标准速率), 无需额外 overlay。

CONFIG_CAN=y
CONFIG_CAN_STM32_BXCAN=y

CONFIG_LOG=y
CONFIG_MAIN_STACK_SIZE=1536
```

## src/main.c
```c
/*
 * SPDX-License-Identifier: Apache-2.0
 *
 * j1939-demo: 把 io_edge_f407vet6 当作一个 J1939 "IO 计测节点"
 *
 * 演示内容:
 *   1. 上电地址声明 (J1939/81, SA 默认 128, 可 Kconfig 改)
 *   2. 周期广播 8 字节 IO 快照 PGN 65280 (0xFF00, 厂商自定义区)
 *   3. 每 N 帧用 TP BAM 发送 16 字节扩展快照 PGN 65281 (0xFF01)
 *   4. 应答 Request (PGN 59904) 对上述 PGN 的请求
 *   5. 打印总线上其他节点的 TP.CM (收包重组未实现, 仅提示)
 *
 * IO 数据为模拟值; 实际项目将 io_sample() 替换为真实 GPIO/ADC 读取。
 */
#include <zephyr/device.h>
#include <zephyr/devicetree.h>
#include <zephyr/kernel.h>
#include <zephyr/logging/log.h>
#include <zephyr/sys/byteorder.h>

#include "j1939.h"

LOG_MODULE_REGISTER(j1939_demo, CONFIG_LOG_DEFAULT_LEVEL);

/* Proprietary B PGN (0xFF00~): 厂商自定义广播区, 不与标准 PGN 冲突 */
#define PGN_IO_STATUS     65280u  /* 0xFF00: 单帧 8B 快照 */
#define PGN_IO_STATUS_EXT 65281u  /* 0xFF01: 16B, 经 TP BAM 发送 */
#define IO_STATUS_PRIO    6u

static uint8_t tx_seq;

/* 模拟 16 路 DI + 4 路 AI (mV) */
static void io_sample(uint16_t di[2], uint16_t ai[4])
{
	di[0] = (uint16_t)(tx_seq * 0x1359u);
	di[1] = (uint16_t)(tx_seq * 0x2468u);
	for (int i = 0; i < 4; i++) {
		ai[i] = (uint16_t)(1500 + (tx_seq * (i + 3)) % 2000);
	}
	tx_seq++;
}

static int send_io_status(void)
{
	uint16_t di[2];
	uint16_t ai[4];
	uint8_t seq = tx_seq;

	io_sample(di, ai);

	/* 单帧: [seq][DI LE16][AI0 LE16][AI1 LE16][保留] */
	uint8_t buf[8] = {
		seq,
		(uint8_t)(di[0] & 0xff), (uint8_t)(di[0] >> 8),
		(uint8_t)(ai[0] & 0xff), (uint8_t)(ai[0] >> 8),
		(uint8_t)(ai[1] & 0xff), (uint8_t)(ai[1] >> 8),
		0xff,
	};

	return j1939_send(IO_STATUS_PRIO, PGN_IO_STATUS,
			  J1939_SA_GLOBAL, buf, sizeof(buf));
}

static int send_io_status_ext(void)
{
	uint16_t di[2];
	uint16_t ai[4];
	uint8_t seq = tx_seq;
	uint8_t buf[16];

	io_sample(di, ai);

	/* 扩展帧: [seq][DI LE16][AI0..3 LE16 x4][uptime 秒 LE32][保留] */
	buf[0] = seq;
	buf[1] = (uint8_t)(di[0] & 0xff);
	buf[2] = (uint8_t)(di[0] >> 8);
	sys_put_le16(ai[0], &buf[3]);
	sys_put_le16(ai[1], &buf[5]);
	sys_put_le16(ai[2], &buf[7]);
	sys_put_le16(ai[3], &buf[9]);
	sys_put_le32((uint32_t)(k_uptime_get() / 1000), &buf[11]);
	buf[15] = 0xff;

	return j1939_send_bam(PGN_IO_STATUS_EXT, buf, sizeof(buf));
}

/* Request (PGN 59904) 应答 */
static bool on_request(uint32_t pgn, uint8_t requester)
{
	switch (pgn) {
	case PGN_IO_STATUS:
		LOG_INF("PGN 65280 requested by SA %u", requester);
		return send_io_status() == 0;
	case PGN_IO_STATUS_EXT:
		LOG_INF("PGN 65281 requested by SA %u", requester);
		return send_io_status_ext() == 0;
	default:
		LOG_INF("PGN %u not supported (from SA %u)", pgn, requester);
		return false;  /* 演示从简: 不回 ACK/NACK (PGN 59392) */
	}
}

/* 演示 PGN 处理器注册: 提示总线上其他节点的多包传输 */
static void on_tp_cm(uint32_t pgn, uint8_t prio, uint8_t sa, uint8_t da,
		     const uint8_t *data, size_t len)
{
	ARG_UNUSED(pgn);
	ARG_UNUSED(prio);
	ARG_UNUSED(da);

	uint8_t ctrl = (len > 0) ? data[0] : 0;

	LOG_INF("TP.CM ctrl 0x%02x from SA %u (RX 重组未实现, 忽略)",
		ctrl, sa);
}

int main(void)
{
	const struct device *can = DEVICE_DT_GET(DT_CHOSEN(zephyr_canbus));
	int ret;

	if (!device_is_ready(can)) {
		LOG_ERR("CAN device %s not ready", can->name);
		return 0;
	}

	/* NAME: 演示用固定值。正式产品应按 J1939/81 选择 Function/
	 * 制造商代码, Identity Number 建议由 MCU 96bit UID 派生以保证唯一 */
	const struct j1939_name name = {
		.function = 40,              /* 演示值 */
		.manufacturer_code = 0x4d2,  /* 演示值 */
		.identity_number = 0x0af12b, /* 演示值 */
	};

	ret = j1939_init(can, j1939_name_pack(&name));
	if (ret != 0) {
		return 0;
	}

	j1939_set_request_handler(on_request);
	j1939_register_handler(J1939_PGN_TP_CM, on_tp_cm);

	/* 地址声明: 失败 (地址耗尽) 则 5s 后重试 */
	while ((ret = j1939_claim_address(CONFIG_J1939_DEMO_PREFERRED_ADDRESS)) != 0) {
		LOG_WRN("address claim failed (%d), retry in 5 s", ret);
		k_sleep(K_SECONDS(5));
	}

	LOG_INF("node up: SA=%u, IO PGN %u/%u, period %d ms",
		j1939_source_address(), PGN_IO_STATUS, PGN_IO_STATUS_EXT,
		CONFIG_J1939_DEMO_TX_PERIOD_MS);

	uint8_t n = 0;

	for (;;) {
		k_sleep(K_MSEC(CONFIG_J1939_DEMO_TX_PERIOD_MS));

		/* 地址被更小 NAME 的节点抢占 -> 重新声明 */
		if (!j1939_address_valid()) {
			LOG_WRN("address lost, re-claiming");
			j1939_claim_address(CONFIG_J1939_DEMO_PREFERRED_ADDRESS);
			continue;
		}

		ret = send_io_status();
		if (ret != 0) {
			LOG_ERR("send failed: %d", ret);
			continue;
		}

		n++;
		if (n % CONFIG_J1939_DEMO_BAM_EVERY_N == 0) {
			send_io_status_ext();
		}
	}

	return 0;
}
```

## src/j1939.c
```c
/*
 * SPDX-License-Identifier: Apache-2.0
 *
 * J1939 核心: CAN 收发 / PGN 分发 / 地址声明 (简化版 J1939/81)
 *
 * 主线 Zephyr 无 J1939 协议栈, 本文件用原生 CAN API 自建:
 *   - 29 位全捕获过滤器 -> msgq -> RX 线程软件分发
 *   - 地址声明: Request 探询 + 0.5~1.5s 竞争窗口 + NAME 数值仲裁,
 *     冲突时让步到下一个更低地址; 未实现完整的 TR1~TR7 定时器组。
 */
#include <errno.h>
#include <string.h>

#include <zephyr/drivers/can.h>
#include <zephyr/kernel.h>
#include <zephyr/logging/log.h>
#include <zephyr/sys/atomic.h>
#include <zephyr/sys/byteorder.h>

#include "j1939.h"

LOG_MODULE_REGISTER(j1939, CONFIG_LOG_DEFAULT_LEVEL);

#define RX_STACK_SIZE  1536
#define RX_MSGQ_DEPTH  16
#define RX_THREAD_PRIO 5

#define CLAIM_PRIO                6u
#define CLAIM_CONTENTION_MIN_MS   500u  /* 竞争窗口 0.5~1.5s */
#define CLAIM_CONTENTION_RAND_MS  1000u
#define CLAIM_SETTLE_MS           250u  /* 声明后的观察期 */

/* 应用可注册的 PGN 处理器上限 */
#define MAX_HANDLERS 8

struct j1939_handler {
	uint32_t pgn;
	j1939_rx_handler_t fn;
};

static const struct device *can_dev;
static uint64_t self_name;

/* 地址声明状态: peer_* 仅在 claim_lock 内修改 */
static struct k_mutex claim_lock;
static uint8_t self_sa = J1939_SA_NULL;
static atomic_t addr_valid = ATOMIC_INIT(false);
static uint8_t claim_candidate_sa;  /* 正在尝试的地址 */
static bool peer_seen;              /* 竞争窗口内出现的同地址声明 */
static uint64_t peer_name;

static struct j1939_handler handlers[MAX_HANDLERS];
static j1939_request_handler_t request_handler;

static void j1939_rx_thread(void *p1, void *p2, void *p3);

K_MSGQ_DEFINE(rx_msgq, sizeof(struct can_frame), RX_MSGQ_DEPTH, 4);
K_THREAD_DEFINE(rx_tid, RX_STACK_SIZE, j1939_rx_thread,
		NULL, NULL, NULL, RX_THREAD_PRIO, 0, 0);

/* ---------------- 发送 ---------------- */

int j1939_send_raw(uint8_t prio, uint32_t pgn, uint8_t sa, uint8_t da,
		   const uint8_t *data, size_t len)
{
	struct can_frame frame = {0};

	if (len > 8) {
		return -EMSGSIZE;
	}

	frame.flags = CAN_FRAME_IDE;
	frame.id = j1939_make_id(prio, pgn, sa, da);
	frame.dlc = (uint8_t)len;
	memcpy(frame.data, data, len);

	return can_send(can_dev, &frame, K_MSEC(100), NULL, NULL);
}

int j1939_send(uint8_t prio, uint32_t pgn, uint8_t da,
	       const uint8_t *data, size_t len)
{
	if (!atomic_get(&addr_valid)) {
		return -EADDRNOTAVAIL;
	}

	/* self_sa 为单字节, ARM 上读写原子; 竞态窗口极小, 演示可接受 */
	return j1939_send_raw(prio, pgn, self_sa, da, data, len);
}

/* ---------------- 地址声明 (J1939/81, 简化) ---------------- */

static void handle_address_claimed(uint8_t sa, const uint8_t *data, uint8_t dlc)
{
	if (dlc < 8) {
		return;
	}

	uint64_t name = sys_get_le64(data);

	k_mutex_lock(&claim_lock, K_FOREVER);

	if (sa == self_sa && atomic_get(&addr_valid) && name != self_name) {
		if (name < self_name) {
			/* 对方 NAME 数值更小 -> 仲裁失败, 我方让出地址 */
			atomic_set(&addr_valid, false);
			LOG_WRN("SA %u lost to NAME %08x:%08x, re-claim needed",
				sa, (unsigned int)(name >> 32), (unsigned int)name);
		}
		/* name > self_name: 我方持有地址, 忽略 (对方应让步) */
	} else if (sa == claim_candidate_sa && !atomic_get(&addr_valid)) {
		/* 竞争窗口内发现地址已被占 */
		peer_seen = true;
		peer_name = name;
	}

	k_mutex_unlock(&claim_lock);
}

int j1939_claim_address(uint8_t preferred_sa)
{
	uint8_t nb[8];
	uint8_t req[3] = {
		(uint8_t)(J1939_PGN_ADDRESS_CLAIMED & 0xff),
		(uint8_t)((J1939_PGN_ADDRESS_CLAIMED >> 8) & 0xff),
		(uint8_t)((J1939_PGN_ADDRESS_CLAIMED >> 16) & 0xff),
	};
	uint8_t sa = preferred_sa;
	int ret = -EADDRNOTAVAIL;

	if (preferred_sa > 253) {
		return -EINVAL;
	}

	sys_put_le64(self_name, nb);

	while (sa < 254) {
		k_mutex_lock(&claim_lock, K_FOREVER);
		claim_candidate_sa = sa;
		peer_seen = false;
		k_mutex_unlock(&claim_lock);

		/* 1) 用试探 SA 探询该地址是否已有主人 (Request DA=sa) */
		j1939_send_raw(CLAIM_PRIO, J1939_PGN_REQUEST,
			       sa, sa, req, sizeof(req));

		/* 2) 竞争窗口 0.5~1.5s (xorshift 抖动): 监听占用者的声明 */
		uint32_t r = k_uptime_get_32();

		r ^= r << 13;
		r ^= r >> 17;
		r ^= r << 5;
		k_sleep(K_MSEC(CLAIM_CONTENTION_MIN_MS + r % CLAIM_CONTENTION_RAND_MS));

		/* 3) 发出自己的地址声明 (全局广播) */
		j1939_send_raw(CLAIM_PRIO, J1939_PGN_ADDRESS_CLAIMED,
			       sa, J1939_SA_GLOBAL, nb, sizeof(nb));

		/* 4) 观察期: 更小 NAME 的反诉会置 peer_seen */
		k_sleep(K_MSEC(CLAIM_SETTLE_MS));

		bool lose;

		k_mutex_lock(&claim_lock, K_FOREVER);
		lose = peer_seen && peer_name < self_name;
		claim_candidate_sa = J1939_SA_NULL;
		if (!lose) {
			self_sa = sa;
			atomic_set(&addr_valid, true);
		}
		k_mutex_unlock(&claim_lock);

		if (lose) {
			LOG_INF("SA %u busy, yielding", sa);
			if (sa == 0) {
				break;
			}
			sa--;  /* 让步策略 (简化): 尝试下一个更低地址 */
			continue;
		}

		LOG_INF("address claimed: SA=%u NAME %08x:%08x", sa,
			(unsigned int)(self_name >> 32), (unsigned int)self_name);
		ret = 0;
		break;
	}

	if (ret != 0) {
		/* 地址耗尽: 广播 Address Not Claimed (SA=254) */
		j1939_send_raw(CLAIM_PRIO, J1939_PGN_ADDRESS_CLAIMED,
			       J1939_SA_NULL, J1939_SA_GLOBAL, nb, sizeof(nb));
	}

	return ret;
}

bool j1939_address_valid(void)
{
	return atomic_get(&addr_valid);
}

uint8_t j1939_source_address(void)
{
	return self_sa;
}

/* ---------------- 接收分发 ---------------- */

static void handle_request(uint8_t sa, uint8_t da,
			   const uint8_t *data, uint8_t dlc)
{
	if (dlc < 3) {
		return;
	}

	/* 规范: 只响应 DA 为本节点或全局的请求 */
	if (da != self_sa && da != J1939_SA_GLOBAL) {
		return;
	}

	uint32_t pgn = (uint32_t)data[0] | ((uint32_t)data[1] << 8) |
		       ((uint32_t)data[2] << 16);

	if (pgn == J1939_PGN_ADDRESS_CLAIMED) {
		/* 收到对我方地址声明的请求: 立即重播声明 */
		if (atomic_get(&addr_valid)) {
			uint8_t nb[8];

			sys_put_le64(self_name, nb);
			j1939_send_raw(CLAIM_PRIO, J1939_PGN_ADDRESS_CLAIMED,
				       self_sa, J1939_SA_GLOBAL, nb, sizeof(nb));
		}
		return;
	}

	if (request_handler != NULL) {
		request_handler(pgn, sa);
	}
}

static void j1939_rx_thread(void *p1, void *p2, void *p3)
{
	struct can_frame frame;

	ARG_UNUSED(p1);
	ARG_UNUSED(p2);
	ARG_UNUSED(p3);

	for (;;) {
		k_msgq_get(&rx_msgq, &frame, K_FOREVER);

		uint32_t can_id = frame.id;
		uint32_t pgn = j1939_id_to_pgn(can_id);
		uint8_t sa = j1939_id_to_sa(can_id);
		uint8_t da = j1939_id_to_da(can_id);
		uint8_t prio = j1939_id_to_priority(can_id);

		if (pgn == J1939_PGN_ADDRESS_CLAIMED) {
			handle_address_claimed(sa, frame.data, frame.dlc);
			continue;
		}

		if (pgn == J1939_PGN_REQUEST) {
			handle_request(sa, da, frame.data, frame.dlc);
			continue;
		}

		for (int i = 0; i < MAX_HANDLERS; i++) {
			if (handlers[i].fn != NULL && handlers[i].pgn == pgn) {
				handlers[i].fn(pgn, prio, sa, da,
					       frame.data, frame.dlc);
			}
		}
	}
}

/* ---------------- 初始化与注册 ---------------- */

int j1939_init(const struct device *can, uint64_t name)
{
	int ret;

	can_dev = can;
	self_name = name;
	k_mutex_init(&claim_lock);

	/* 启动 CAN 控制器 (板级 DTS 已配好 J1939 要求的 250 kbps) */
	ret = can_start(can_dev);
	if (ret != 0 && ret != -EALREADY) {
		LOG_ERR("can_start failed: %d", ret);
		return ret;
	}

	/* 29 位全捕获过滤器, PGN 分发在软件层完成。
	 * 若要硬件过滤某个 PDU2 PGN, 只需匹配 ID[25:8]:
	 *   .id = pgn << 8, .mask = 0x3ffff00, .flags = CAN_FILTER_IDE
	 * (PDU1 PGN 的 PS 位是目标地址, DA 会变化, 无法用单一过滤器匹配,
	 *  需为 DA=本机 与 DA=全局 各建一个。) */
	const struct can_filter filter = {
		.id = 0x00000000,
		.mask = 0x00000000,
		.flags = CAN_FILTER_IDE,
	};

	ret = can_add_rx_filter_msgq(can_dev, &rx_msgq, &filter);
	if (ret < 0) {
		LOG_ERR("can_add_rx_filter_msgq failed: %d", ret);
		return ret;
	}

	LOG_INF("J1939 stack ready (bitrate from DTS)");
	return 0;
}

int j1939_register_handler(uint32_t pgn, j1939_rx_handler_t handler)
{
	for (int i = 0; i < MAX_HANDLERS; i++) {
		if (handlers[i].fn == NULL) {
			handlers[i].pgn = pgn;
			handlers[i].fn = handler;
			return 0;
		}
	}

	return -ENOSPC;
}

void j1939_set_request_handler(j1939_request_handler_t handler)
{
	request_handler = handler;
}
```

## src/j1939.h
```c
/*
 * SPDX-License-Identifier: Apache-2.0
 *
 * 极简 SAE J1939 协议栈 (演示级, 基于 Zephyr 原生 CAN API)
 *
 * 实现范围:
 *   - 29 位 ID 编解码 (优先级 / PGN / SA / DA)          (J1939/21)
 *   - PDU1 (点对点) 与 PDU2 (纯广播) 寻址
 *   - 地址声明: 竞争窗口 + NAME 仲裁 + 让步重试 (简化)   (J1939/81)
 *   - PGN 59904 Request 请求-应答分发
 *   - TP BAM 多包发送 (j1939_tp.c)                       (J1939/21)
 *
 * 未实现 (按需扩展): TP 收包重组、RTS/CTS 流控、J1939/73 诊断、
 * J1939/74 配置刷写、地址声明完整定时器组 (TR1~TR7)。
 */
#ifndef J1939_H
#define J1939_H

#include <stdbool.h>
#include <stddef.h>
#include <stdint.h>

#include <zephyr/device.h>
#include <zephyr/kernel.h>

#ifdef __cplusplus
extern "C" {
#endif

/* ---------- 常用 PGN (详见 J1939-DA) ---------- */
#define J1939_PGN_REQUEST         59904u  /* 0xEA00, PDU1, 请求某 PGN */
#define J1939_PGN_TP_DT           60160u  /* 0xEB00, PDU1, TP 数据帧 */
#define J1939_PGN_TP_CM           60416u  /* 0xEC00, PDU1, TP 控制帧 */
#define J1939_PGN_ADDRESS_CLAIMED 60928u  /* 0xEE00, PDU1, 地址声明 */

/* ---------- 优先级 (0 最高, 7 最低) ---------- */
#define J1939_PRIORITY_HIGHEST 0u
#define J1939_PRIORITY_LOWEST  7u

/* ---------- 特殊源地址 ---------- */
#define J1939_SA_NULL   254u  /* 未获得有效地址 */
#define J1939_SA_GLOBAL 255u  /* 全局广播 */

/* J1939/21 TP 单次传输上限: 255 包 x 7 字节 */
#define J1939_MAX_DATA 1785u

/* ---------- 29 位 ID <-> 协议字段 ----------
 *
 *  28...26 | 25 | 24 | 23.....16 | 15......8 | 7......0
 *  PRI     | R  | DP |    PF     |  PS/DA    |   SA
 */
#define J1939_ID_MASK 0x1fffffffu

static inline bool j1939_pgn_is_pdu2(uint32_t pgn)
{
	/* PF >= 0xF0 为 PDU2 (PS 为组扩展, 只能广播) */
	return ((pgn >> 8) & 0xffu) >= 0xf0u;
}

/* 构造 29 位 ID。PDU1 的 PGN 低位字节约定为 0 (如 0xEA00), DA 填入 PS;
 * PDU2 的组扩展已在 PGN 中, DA 参数被忽略。 */
static inline uint32_t j1939_make_id(uint8_t prio, uint32_t pgn,
				     uint8_t sa, uint8_t da)
{
	uint32_t id = ((uint32_t)(prio & 0x07u) << 26) |
		      ((pgn & 0x3ffffu) << 8) | sa;

	if (!j1939_pgn_is_pdu2(pgn)) {
		id |= (uint32_t)da << 8;
	}
	return id;
}

static inline uint8_t j1939_id_to_priority(uint32_t can_id)
{
	return (uint8_t)((can_id >> 26) & 0x07u);
}

static inline uint8_t j1939_id_to_sa(uint32_t can_id)
{
	return (uint8_t)(can_id & 0xffu);
}

/* PDU1 时返回目标地址 (DA), PDU2 时为组扩展 */
static inline uint8_t j1939_id_to_da(uint32_t can_id)
{
	return (uint8_t)((can_id >> 8) & 0xffu);
}

static inline uint32_t j1939_id_to_pgn(uint32_t can_id)
{
	uint8_t pf = (uint8_t)((can_id >> 16) & 0xffu);

	if (pf >= 0xf0u) {
		return (can_id >> 8) & 0x3ffffu;  /* PDU2: 含组扩展 */
	}
	return (can_id >> 8) & 0x3ff00u;      /* PDU1: 去掉 DA 位 */
}

/* ---------- NAME (64 位设备名, J1939/81) ----------
 * 位域: [0:2] ECU实例 [3:7] 功能实例 [8:15] 功能 [16] 保留
 *       [17:23] 车辆系统 [24:27] 车辆系统实例 [28:30] 行业组 [31] 保留
 *       [32:52] 序列号 [53:63] 制造商代码
 */
struct j1939_name {
	uint8_t ecu_instance;            /* 3 bit */
	uint8_t function_instance;       /* 5 bit */
	uint8_t function;                /* 8 bit, 功能码表见 J1939/81 */
	uint8_t vehicle_system;          /* 7 bit */
	uint8_t vehicle_system_instance; /* 4 bit */
	uint8_t industry_group;          /* 3 bit */
	uint16_t manufacturer_code;      /* 11 bit */
	uint32_t identity_number;        /* 21 bit */
};

static inline uint64_t j1939_name_pack(const struct j1939_name *n)
{
	return (uint64_t)(n->ecu_instance & 0x07u) |
	       ((uint64_t)(n->function_instance & 0x1fu) << 3) |
	       ((uint64_t)n->function << 8) |
	       ((uint64_t)(n->vehicle_system & 0x7fu) << 17) |
	       ((uint64_t)(n->vehicle_system_instance & 0x0fu) << 24) |
	       ((uint64_t)(n->industry_group & 0x07u) << 28) |
	       ((uint64_t)(n->identity_number & 0x1fffffu) << 32) |
	       ((uint64_t)(n->manufacturer_code & 0x7ffu) << 53);
}

/* ---------- 应用回调 ---------- */

/* 收到已注册 PGN 的单帧报文 (TP 长报文不在此分发) */
typedef void (*j1939_rx_handler_t)(uint32_t pgn, uint8_t prio, uint8_t sa,
				   uint8_t da, const uint8_t *data,
				   size_t len);

/* 收到对某 PGN 的 Request; 返回 true 表示已处理并应答 */
typedef bool (*j1939_request_handler_t)(uint32_t pgn, uint8_t requester_sa);

/* ---------- API ---------- */

/* 初始化协议栈: 启动 CAN 控制器, 挂 29 位全捕获过滤器, 启动 RX 线程 */
int j1939_init(const struct device *can, uint64_t name);

/* 阻塞式地址声明 (含竞争窗口, 最长 ~1.75s/地址)。
 * 0 = 成功; -EADDRNOTAVAIL = 地址耗尽 (已广播 Cannot Claim)。 */
int j1939_claim_address(uint8_t preferred_sa);

bool j1939_address_valid(void);
uint8_t j1939_source_address(void);

/* 发送单帧 (len <= 8)。da 仅对 PDU1 PGN 有效, PDU2 忽略。 */
int j1939_send(uint8_t prio, uint32_t pgn, uint8_t da,
	       const uint8_t *data, size_t len);

/* 多包 BAM 广播 (J1939/21), 9 ~ 1785 字节, 阻塞执行
 * (帧间隔 55ms, 16 字节约耗时 110ms)。len <= 8 时退化为单帧。 */
int j1939_send_bam(uint32_t pgn, const uint8_t *data, size_t len);

int j1939_register_handler(uint32_t pgn, j1939_rx_handler_t handler);
void j1939_set_request_handler(j1939_request_handler_t handler);

/* 库内部使用: 不校验地址有效性、显式指定 SA 的裸发送 */
int j1939_send_raw(uint8_t prio, uint32_t pgn, uint8_t sa, uint8_t da,
		   const uint8_t *data, size_t len);

#ifdef __cplusplus
}
#endif

#endif /* J1939_H */
```

## src/j1939_tp.c
```c
/*
 * SPDX-License-Identifier: Apache-2.0
 *
 * J1939/21 传输层: BAM (Broadcast Announce Message) 多包发送
 *
 * 用 TP.CM (PGN 60416) 广播控制帧, 再用 TP.DT (PGN 60160) 以
 * 55ms 间隔 (规范要求 >= 50ms) 发出全部数据帧, 接收方不确认。
 * 报文最长 1785 字节 (255 包 x 7 字节)。
 *
 * 未实现: 接收端重组、RTS/CTS 点对点流控 (TP.CM_RTS/CTS/EOM)。
 */
#include <errno.h>
#include <string.h>

#include <zephyr/kernel.h>
#include <zephyr/logging/log.h>
#include <zephyr/sys/util.h>

#include "j1939.h"

LOG_MODULE_REGISTER(j1939_tp, CONFIG_LOG_DEFAULT_LEVEL);

#define TP_CM_BAM       0x20u  /* BAM 控制字节 */
#define TP_FRAME_GAP_MS 55u    /* 规范: 数据帧间隔 >= 50ms */
#define TP_PRIO         7u     /* 传输层报文用最低优先级 */

int j1939_send_bam(uint32_t pgn, const uint8_t *data, size_t len)
{
	uint8_t cm[8];
	uint8_t dt[8];
	size_t off = 0;
	uint8_t seq = 1;
	uint8_t sa;
	int ret;

	if (!j1939_address_valid()) {
		return -EADDRNOTAVAIL;
	}
	if (len == 0 || len > J1939_MAX_DATA) {
		return -EINVAL;
	}
	if (len <= 8) {
		/* 单帧足够, 退化为普通发送 */
		return j1939_send(TP_PRIO, pgn, J1939_SA_GLOBAL, data, len);
	}

	sa = j1939_source_address();

	/* TP.CM BAM: [控制字节][总长 LE16][总包数][保留][目标 PGN LE24] */
	cm[0] = TP_CM_BAM;
	cm[1] = (uint8_t)(len & 0xff);
	cm[2] = (uint8_t)((len >> 8) & 0xff);
	cm[3] = (uint8_t)((len + 6) / 7);
	cm[4] = 0xff;
	cm[5] = (uint8_t)(pgn & 0xff);
	cm[6] = (uint8_t)((pgn >> 8) & 0xff);
	cm[7] = (uint8_t)((pgn >> 16) & 0xff);

	ret = j1939_send_raw(TP_PRIO, J1939_PGN_TP_CM, sa,
			     J1939_SA_GLOBAL, cm, sizeof(cm));
	if (ret != 0) {
		return ret;
	}

	/* TP.DT: [序号][7 字节数据], 尾帧用 0xFF 填充 */
	while (off < len) {
		size_t n = MIN(7, len - off);

		dt[0] = seq++;
		memcpy(&dt[1], &data[off], n);
		memset(&dt[1 + n], 0xff, 7 - n);

		ret = j1939_send_raw(TP_PRIO, J1939_PGN_TP_DT, sa,
				     J1939_SA_GLOBAL, dt, sizeof(dt));
		if (ret != 0) {
			LOG_ERR("TP.DT seq %u failed: %d", seq - 1, ret);
			return ret;
		}

		off += n;
		if (off < len) {
			k_sleep(K_MSEC(TP_FRAME_GAP_MS));
		}
	}

	return 0;
}
```
