## CMakeLists.txt
```
cmake_minimum_required(VERSION 3.20.0)
find_package(Zephyr REQUIRED HINTS $ENV{ZEPHYR_BASE})

project(eth_bwtest)

target_sources(app PRIVATE main.c src/bwtest.c src/bench_shell.c src/mdio_scan.c)
```

## prj.conf
```kconfig
CONFIG_LOG=y

CONFIG_NETWORKING=y
CONFIG_NET_IPV4=y
CONFIG_NET_IPV6=n
CONFIG_NET_UDP=y
CONFIG_NET_TCP=y
CONFIG_NET_L2_ETHERNET=y
CONFIG_NET_SOCKETS=y

# 静态 IPv4: 网线直连开发机 enp3s0 (192.168.12.100/24)
CONFIG_NET_CONFIG_SETTINGS=y
CONFIG_NET_CONFIG_MY_IPV4_ADDR="192.168.12.200"
CONFIG_NET_CONFIG_MY_IPV4_NETMASK="255.255.255.0"
CONFIG_NET_CONFIG_MY_IPV4_GW=""

CONFIG_NET_SHELL=y
CONFIG_NET_STATISTICS=y

# 网络栈缓冲: 1536 字节/包, 供百兆线速收发 (默认 128B 分片会把 TCP 拖死)。
# H743 AXI SRAM 512KB, 池子按 120x2 个整帧估算 (~360KB), 实测占用 ~420KB。
CONFIG_NET_BUF_DATA_SIZE=1536
CONFIG_NET_BUF_RX_COUNT=120
CONFIG_NET_BUF_TX_COUNT=120
CONFIG_NET_PKT_RX_COUNT=32
CONFIG_NET_PKT_TX_COUNT=32

CONFIG_ENTROPY_GENERATOR=y

# PHY 驱动 (apps/drivers/yt8512)
CONFIG_PHY_MOTORCOMM_YT8512=y

CONFIG_MAIN_STACK_SIZE=4096
CONFIG_NET_TC_THREAD_PREEMPTIVE=y
# TX 异步模式实测会卡死带负载的发送 (echo/UDP 全挂, 小包 ACK 正常), 不开
CONFIG_ETH_STM32_HAL_RX_THREAD_STACK_SIZE=2048

# main.c 用 net_mgmt 事件等网络就绪
CONFIG_NET_MGMT=y
CONFIG_NET_MGMT_EVENT=y

# zperf (iperf2 兼容) 带宽测试: shell 里 zperf tcp/udp upload/download,
# 与主机 iperf2 联测 (iperf3 协议不兼容 zperf, 见 README)
CONFIG_NET_ZPERF=y
CONFIG_NET_ZPERF_SERVER=y
CONFIG_NET_ZPERF_MAX_PACKET_SIZE=1472
CONFIG_NET_ZPERF_LOG_LEVEL_INF=y
CONFIG_NET_LOG=y
# zperf 的 TCP+UDP 接收服务需要 4+1 个 poll 表项 (默认 3 会让 socket
# service 线程启动失败, zperf server 报 "Cannot register socket service")
CONFIG_ZVFS_POLL_MAX=10

CONFIG_SHELL=y
```

## src/bench_shell.c
```c
/*
 * UDP performance benchmark shell commands, ported from eth-echo's
 * src/bench_shell.c:
 *
 *   bench tx [count=100] [size=64] [ip=192.168.12.100] [port=19602]
 *       board -> host one-way TX throughput (seq in payload for
 *       host-side loss accounting)
 *   bench rx [port=19601] [duration_ms=5000]
 *       host floods the board (host/udp_flood.py), board counts pkts/bytes
 *   bench bidir [duration_ms=5000] [size=64] [rx_port=19601]
 *       one socket sending to host and draining its own RX
 *
 * Benchmark ports stay 19601/19602 to keep away from the TCP test
 * endpoint (9900).
 */

#include <zephyr/kernel.h>
#include <zephyr/net/socket.h>
#include <zephyr/shell/shell.h>
#include <zephyr/sys/byteorder.h>
#include <zephyr/logging/log.h>
#include <stdlib.h>
#include <string.h>
#include <errno.h>

LOG_MODULE_REGISTER(bench, LOG_LEVEL_INF);

#define BENCH_HOST_IP_DEF	"192.168.12.100"
#define BENCH_TX_COUNT_DEF	100
#define BENCH_TX_COUNT_MAX	1000
#define BENCH_TX_SIZE_DEF	64
#define BENCH_TX_SIZE_MAX	1472	/* UDP payload 上限 (1514 帧减头部) */
#define BENCH_RX_DUR_DEF	5000
#define BENCH_RX_DUR_MAX	30000
#define BENCH_PORT_TX_DEF	19602
#define BENCH_PORT_RX_DEF	19601

static uint8_t bench_buf[BENCH_TX_SIZE_MAX];

static int cmd_bench_tx(const struct shell *ctx, size_t argc, char **argv)
{
	int count = BENCH_TX_COUNT_DEF;
	int size = BENCH_TX_SIZE_DEF;
	const char *ip = BENCH_HOST_IP_DEF;
	int port = BENCH_PORT_TX_DEF;

	if (argc >= 2) {
		count = (int)strtol(argv[1], NULL, 10);
		count = CLAMP(count, 1, BENCH_TX_COUNT_MAX);
	}
	if (argc >= 3) {
		size = (int)strtol(argv[2], NULL, 10);
		size = CLAMP(size, 1, BENCH_TX_SIZE_MAX);
	}
	if (argc >= 4) {
		ip = argv[3];
	}
	if (argc >= 5) {
		port = (int)strtol(argv[4], NULL, 10);
		if (port < 1 || port > 65535) {
			shell_error(ctx, "invalid port: %s", argv[4]);
			return -EINVAL;
		}
	}

	int sock = zsock_socket(AF_INET, SOCK_DGRAM, IPPROTO_UDP);

	if (sock < 0) {
		shell_error(ctx, "socket create failed: %d", errno);
		return -EIO;
	}

	struct sockaddr_in dst = {
		.sin_family = AF_INET,
		.sin_port = htons(port),
	};

	if (zsock_inet_pton(AF_INET, ip, &dst.sin_addr) != 1) {
		shell_error(ctx, "invalid ip: %s", ip);
		zsock_close(sock);
		return -EINVAL;
	}

	memset(bench_buf, 0xAA, sizeof(bench_buf));
	shell_print(ctx, "TX bench: %d pkts x %d B -> %s:%d", count, size, ip, port);

	uint32_t t0 = k_uptime_get_32();
	int sent = 0;
	int fail = 0;

	for (int i = 0; i < count; i++) {
		sys_put_le32((uint32_t)i, bench_buf);
		int ret = zsock_sendto(sock, bench_buf, size, 0,
					(struct sockaddr *)&dst, sizeof(dst));
		if (ret < 0) {
			fail++;
			if (fail <= 3) {
				shell_warn(ctx, "  sendto failed @%d: errno %d",
					   i, errno);
			}
		} else {
			sent++;
		}
	}

	uint32_t elapsed = k_uptime_get_32() - t0;
	zsock_close(sock);

	uint32_t total_bytes = (uint32_t)sent * (uint32_t)size;

	shell_print(ctx, "done: %d sent, %d failed", sent, fail);
	shell_print(ctx, "data: %u B in %u ms", total_bytes, elapsed);
	if (elapsed > 0) {
		shell_print(ctx, "rate: %u pkt/s, %u B/s",
			    (uint32_t)sent * 1000U / elapsed,
			    total_bytes * 1000U / elapsed);
	}
	return 0;
}

static int cmd_bench_rx(const struct shell *ctx, size_t argc, char **argv)
{
	int port = BENCH_PORT_RX_DEF;
	int duration = BENCH_RX_DUR_DEF;

	if (argc >= 2) {
		port = (int)strtol(argv[1], NULL, 10);
		if (port < 1 || port > 65535) {
			shell_error(ctx, "invalid port: %s", argv[1]);
			return -EINVAL;
		}
	}
	if (argc >= 3) {
		duration = (int)strtol(argv[2], NULL, 10);
		duration = CLAMP(duration, 100, BENCH_RX_DUR_MAX);
	}

	int sock = zsock_socket(AF_INET, SOCK_DGRAM, IPPROTO_UDP);

	if (sock < 0) {
		shell_error(ctx, "socket create failed: %d", errno);
		return -EIO;
	}

	struct sockaddr_in local = {
		.sin_family = AF_INET,
		.sin_port = htons(port),
	};

	if (zsock_bind(sock, (struct sockaddr *)&local, sizeof(local)) < 0) {
		shell_error(ctx, "bind :%d failed: %d", port, errno);
		zsock_close(sock);
		return -EIO;
	}

	shell_print(ctx, "RX bench: listening on :%d for %d ms", port, duration);
	shell_print(ctx, "(flood 192.168.12.200:%d from host: "
			"host/udp_flood.py 192.168.12.200 --port %d)", port, port);

	uint32_t t0 = k_uptime_get_32();
	uint32_t deadline = t0 + (uint32_t)duration;
	uint32_t last_print = t0;
	uint32_t pkt_count = 0;
	uint32_t byte_count = 0;
	uint32_t max_gap_ms = 0;

	while (k_uptime_get_32() < deadline) {
		ssize_t n = zsock_recvfrom(sock, bench_buf, sizeof(bench_buf),
					   ZSOCK_MSG_DONTWAIT, NULL, NULL);
		if (n > 0) {
			pkt_count++;
			byte_count += (uint32_t)n;
		} else {
			uint32_t s0 = k_uptime_get_32();

			k_msleep(1);
			max_gap_ms = MAX(max_gap_ms, k_uptime_get_32() - s0);
		}
		uint32_t now = k_uptime_get_32();

		if (now - last_print >= 1000) {
			shell_print(ctx, "  ... %u pkts, %u B", pkt_count, byte_count);
			last_print = now;
		}
	}

	uint32_t elapsed = k_uptime_get_32() - t0;
	zsock_close(sock);

	shell_print(ctx, "done: %u pkts, %u B in %u ms", pkt_count, byte_count, elapsed);
	if (elapsed > 0 && pkt_count > 0) {
		shell_print(ctx, "rate: %u pkt/s, %u B/s (%u.%02u Mbit/s)",
			    pkt_count * 1000U / elapsed,
			    byte_count * 1000U / elapsed,
			    byte_count * 8U / elapsed / 1000000U,
			    (byte_count * 8U / elapsed / 1000U) % 1000U);
	}
	shell_print(ctx, "longest empty poll: %u ms", max_gap_ms);
	return 0;
}

static int cmd_bench_bidir(const struct shell *ctx, size_t argc, char **argv)
{
	int duration = BENCH_RX_DUR_DEF;
	int size = BENCH_TX_SIZE_DEF;
	int rx_port = BENCH_PORT_RX_DEF;

	if (argc >= 2) {
		duration = (int)strtol(argv[1], NULL, 10);
		duration = CLAMP(duration, 100, BENCH_RX_DUR_MAX);
	}
	if (argc >= 3) {
		size = (int)strtol(argv[2], NULL, 10);
		size = CLAMP(size, 1, BENCH_TX_SIZE_MAX);
	}
	if (argc >= 4) {
		rx_port = (int)strtol(argv[3], NULL, 10);
		if (rx_port < 1 || rx_port > 65535) {
			shell_error(ctx, "invalid port: %s", argv[3]);
			return -EINVAL;
		}
	}

	int sock = zsock_socket(AF_INET, SOCK_DGRAM, IPPROTO_UDP);

	if (sock < 0) {
		shell_error(ctx, "socket create failed: %d", errno);
		return -EIO;
	}

	struct sockaddr_in local = {
		.sin_family = AF_INET,
		.sin_port = htons(rx_port),
	};

	if (zsock_bind(sock, (struct sockaddr *)&local, sizeof(local)) < 0) {
		shell_error(ctx, "bind :%d failed: %d", rx_port, errno);
		zsock_close(sock);
		return -EIO;
	}

	struct sockaddr_in dst = {
		.sin_family = AF_INET,
		.sin_port = htons(BENCH_PORT_TX_DEF),
	};

	if (zsock_inet_pton(AF_INET, BENCH_HOST_IP_DEF, &dst.sin_addr) != 1) {
		zsock_close(sock);
		return -EINVAL;
	}

	memset(bench_buf, 0xAA, sizeof(bench_buf));
	shell_print(ctx, "BIDIR: TX->%s:%d  RX on :%d  %d ms  %d B/pkt",
		    BENCH_HOST_IP_DEF, BENCH_PORT_TX_DEF, rx_port, duration, size);

	uint32_t t0 = k_uptime_get_32();
	uint32_t deadline = t0 + (uint32_t)duration;
	uint32_t last_print = t0;
	uint32_t tx_sent = 0, tx_fail = 0;
	uint32_t rx_pkts = 0, rx_bytes = 0;
	uint32_t seq = 0;

	while (k_uptime_get_32() < deadline) {
		sys_put_le32(seq++, bench_buf);
		int ret = zsock_sendto(sock, bench_buf, size, 0,
					(struct sockaddr *)&dst, sizeof(dst));
		if (ret < 0) {
			tx_fail++;
		} else {
			tx_sent++;
		}

		for (int drain = 0;
		     drain < 32 && k_uptime_get_32() < deadline;
		     drain++) {
			ssize_t n = zsock_recvfrom(sock, bench_buf,
						   sizeof(bench_buf),
						   ZSOCK_MSG_DONTWAIT, NULL, NULL);

			if (n <= 0) {
				break;
			}
			rx_pkts++;
			rx_bytes += (uint32_t)n;
		}

		uint32_t now = k_uptime_get_32();

		if (now - last_print >= 1000) {
			shell_print(ctx, "  ... TX %u, RX %u pkts", tx_sent, rx_pkts);
			last_print = now;
		}
	}

	uint32_t elapsed = k_uptime_get_32() - t0;
	zsock_close(sock);

	uint32_t tx_bytes = tx_sent * (uint32_t)size;

	shell_print(ctx, "TX: %u sent, %u failed, %u B", tx_sent, tx_fail, tx_bytes);
	shell_print(ctx, "RX: %u pkts, %u B", rx_pkts, rx_bytes);
	shell_print(ctx, "time: %u ms", elapsed);
	if (elapsed > 0) {
		shell_print(ctx, "TX rate: %u pkt/s, %u B/s",
			    tx_sent * 1000U / elapsed, tx_bytes * 1000U / elapsed);
		if (rx_pkts > 0) {
			shell_print(ctx, "RX rate: %u pkt/s, %u B/s",
				    rx_pkts * 1000U / elapsed,
				    rx_bytes * 1000U / elapsed);
		}
	}
	return 0;
}

SHELL_STATIC_SUBCMD_SET_CREATE(
	sub_bench_cmds,
	SHELL_CMD_ARG(tx, NULL,
		      "bench tx [count=100] [size=64] [ip] [port=19602]",
		      cmd_bench_tx, 1, 4),
	SHELL_CMD_ARG(rx, NULL,
		      "bench rx [port=19601] [duration_ms=5000]",
		      cmd_bench_rx, 1, 2),
	SHELL_CMD_ARG(bidir, NULL,
		      "bench bidir [duration_ms=5000] [size=64] [rx_port=19601]",
		      cmd_bench_bidir, 1, 3),
	SHELL_SUBCMD_SET_END);

SHELL_CMD_REGISTER(bench, &sub_bench_cmds, "UDP performance benchmark", NULL);
```

## src/bwtest.c
```c
/*
 * TCP bandwidth test endpoint, ported from eth-echo's src/bwtest.c.
 *
 *  - TCP server on port 9900
 *  - single connection; the first byte selects the mode:
 *      'R'  receive-only sink (board RX / host->board downlink capacity)
 *      any  echo (bidirectional throughput)
 *  - board logs received bytes / elapsed time / rate when the peer
 *    disconnects; host side rate is reported by host/tcp_send.py
 */

#include <zephyr/kernel.h>
#include <zephyr/net/socket.h>
#include <zephyr/logging/log.h>

LOG_MODULE_REGISTER(bwtest, LOG_LEVEL_INF);

#define BW_PORT		9900
#define BW_BUF_SIZE	4096
#define BW_THREAD_PRIO	15

static void bw_sink_session(int c)
{
	static uint8_t sink[BW_BUF_SIZE];
	ssize_t n;
	uint64_t total = 0U;
	uint32_t t0 = k_uptime_get_32();

	while ((n = zsock_recv(c, sink, sizeof(sink), 0)) > 0) {
		total += n;
	}

	uint32_t elapsed = k_uptime_get_32() - t0;

	if (elapsed > 0) {
		LOG_INF("BW sink done: %u KB in %u ms: %u KB/s (%u.%02u Mbit/s)",
			(uint32_t)(total / 1024U), elapsed,
			(uint32_t)((total / 1024U) * 1000U / elapsed),
			(uint32_t)(total * 8U / elapsed / 1000000U),
			(uint32_t)((total * 8U / elapsed / 1000U) % 1000U));
	} else {
		LOG_INF("BW sink done: %u KB (too fast to measure)", (uint32_t)(total / 1024U));
	}
}

static void bw_echo_session(int c)
{
	static uint8_t buf[BW_BUF_SIZE];
	int nodelay = 1;
	ssize_t n;

	/* Zephyr TCP 栈不开 NODELAY 时, 回环每段都要等一次 ACK */
	(void)zsock_setsockopt(c, IPPROTO_TCP, TCP_NODELAY,
			       &nodelay, sizeof(nodelay));

	while ((n = zsock_recv(c, buf, sizeof(buf), 0)) > 0) {
		ssize_t off = 0;

		while (off < n) {
			ssize_t w = zsock_send(c, buf + off, n - off, 0);

			if (w < 0) {
				LOG_ERR("send failed: %d", errno);
				return;
			}
			off += w;
		}
	}
}

static void bw_thread(void *p1, void *p2, void *p3)
{
	ARG_UNUSED(p1);
	ARG_UNUSED(p2);
	ARG_UNUSED(p3);

	int serv = zsock_socket(AF_INET, SOCK_STREAM, IPPROTO_TCP);

	if (serv < 0) {
		LOG_ERR("socket failed: %d", errno);
		return;
	}

	struct sockaddr_in addr = {
		.sin_family = AF_INET,
		.sin_addr.s_addr = htonl(INADDR_ANY),
		.sin_port = htons(BW_PORT),
	};

	if (zsock_bind(serv, (struct sockaddr *)&addr, sizeof(addr)) < 0 ||
	    zsock_listen(serv, 1) < 0) {
		LOG_ERR("bind/listen failed: %d", errno);
		zsock_close(serv);
		return;
	}

	LOG_INF("BW test TCP server on port %d ('R' = sink, else echo)", BW_PORT);

	while (true) {
		int c = zsock_accept(serv, NULL, NULL);

		if (c < 0) {
			continue;
		}
		LOG_INF("BW test client connected");

		/* 首字节选模式: 'R' = 纯收流, 其他 = 回环 */
		uint8_t mode = 0;

		if (zsock_recv(c, &mode, 1, 0) == 1 && mode != 'R') {
			bw_echo_session(c);
		} else {
			bw_sink_session(c);
		}

		LOG_INF("BW test client done");
		zsock_close(c);
	}
}

K_THREAD_DEFINE(bw_test, 4096, bw_thread, NULL, NULL, NULL,
		BW_THREAD_PRIO, 0, 0);
```

## src/mdio_scan.c
```c
/*
 * MDIO 总线调试 shell 命令 (bring-up 用):
 *
 *   mdio scan                 扫描地址 0..31, 列出应答的 PHY 及其 ID
 *   mdio read <addr> <reg>    读 PHY 寄存器
 *   mdio write <addr> <reg> <val>  写 PHY 寄存器
 *
 * 若 DTS 里 ethernet-phy@N 的 N 配错, PHY 驱动初始化会报
 * "not a YT8512" / "MDIO read failed", 用 mdio scan 找到实际地址后
 * 改 board DTS 的 reg 即可。
 *
 * 注意: 与 PHY 驱动的周期链路监控并发访问同一条 MDIO 总线,
 * 仅用于调试, 不保证读写原子性。
 */

#include <zephyr/kernel.h>
#include <zephyr/shell/shell.h>
#include <zephyr/drivers/mdio.h>
#include <zephyr/net/mii.h>
#include <errno.h>
#include <stdlib.h>

#if DT_NODE_HAS_STATUS(DT_NODELABEL(mdio), okay)

static const struct device *const mdio_dev = DEVICE_DT_GET(DT_NODELABEL(mdio));

static int cmd_mdio_scan(const struct shell *ctx, size_t argc, char **argv)
{
	ARG_UNUSED(argc);
	ARG_UNUSED(argv);

	int found = 0;

	shell_print(ctx, "scanning MDIO bus %s ...", mdio_dev->name);

	for (uint8_t addr = 0; addr < 32; addr++) {
		uint16_t id1 = 0, id2 = 0;

		if (mdio_read(mdio_dev, addr, MII_PHYID1R, &id1) < 0 ||
		    mdio_read(mdio_dev, addr, MII_PHYID2R, &id2) < 0) {
			continue;
		}
		/* 总线无应答读回全 1, 全 0 也不是有效 PHY */
		if ((id1 == 0xFFFFU && id2 == 0xFFFFU) ||
		    (id1 == 0x0000U && id2 == 0x0000U)) {
			continue;
		}

		uint16_t bmsr = 0;

		(void)mdio_read(mdio_dev, addr, MII_BMSR, &bmsr);
		shell_print(ctx,
			    "PHY @0x%02X: ID 0x%04X.%04X (YT8512 Type_No=0x12), "
			    "BMSR 0x%04X%s%s",
			    addr, id1, id2, bmsr,
			    (bmsr & MII_BMSR_LINK_STATUS) ? ", link up" : "",
			    (bmsr & MII_BMSR_AUTONEG_COMPLETE) ? ", autoneg done" : "");
		found++;
	}

	if (found == 0) {
		shell_error(ctx, "no PHY responded on the MDIO bus");
		return -ENODEV;
	}

	return 0;
}

static int cmd_mdio_read(const struct shell *ctx, size_t argc, char **argv)
{
	uint8_t addr = (uint8_t)strtol(argv[1], NULL, 0);
	uint8_t reg = (uint8_t)strtol(argv[2], NULL, 0);
	uint16_t val = 0;

	if (mdio_read(mdio_dev, addr, reg, &val) < 0) {
		shell_error(ctx, "mdio read %s failed: %d", mdio_dev->name, errno);
		return -EIO;
	}

	shell_print(ctx, "phy 0x%02X reg 0x%02X = 0x%04X", addr, reg, val);
	return 0;
}

static int cmd_mdio_write(const struct shell *ctx, size_t argc, char **argv)
{
	uint8_t addr = (uint8_t)strtol(argv[1], NULL, 0);
	uint8_t reg = (uint8_t)strtol(argv[2], NULL, 0);
	uint16_t val = (uint16_t)strtol(argv[3], NULL, 0);

	if (mdio_write(mdio_dev, addr, reg, val) < 0) {
		shell_error(ctx, "mdio write %s failed: %d", mdio_dev->name, errno);
		return -EIO;
	}

	shell_print(ctx, "phy 0x%02X reg 0x%02X <- 0x%04X", addr, reg, val);
	return 0;
}

SHELL_STATIC_SUBCMD_SET_CREATE(
	sub_mdio_cmds,
	SHELL_CMD_ARG(scan, NULL, "scan MDIO bus for PHYs (addr 0..31)", cmd_mdio_scan, 1, 0),
	SHELL_CMD_ARG(read, NULL, "read PHY register: mdio read <addr> <reg>",
		      cmd_mdio_read, 3, 0),
	SHELL_CMD_ARG(write, NULL, "write PHY register: mdio write <addr> <reg> <val>",
		      cmd_mdio_write, 4, 0),
	SHELL_SUBCMD_SET_END);

SHELL_CMD_REGISTER(mdio, &sub_mdio_cmds, "MDIO bus debug tools", NULL);

#else /* no mdio node */
#warning "board has no enabled mdio node; mdio shell commands are stubs"

static int cmd_mdio_none(const struct shell *ctx, size_t argc, char **argv)
{
	shell_error(ctx, "board has no enabled mdio node in devicetree");
	return -ENODEV;
}

SHELL_STATIC_SUBCMD_SET_CREATE(
	sub_mdio_cmds,
	SHELL_CMD_ARG(scan, NULL, "scan MDIO bus for PHYs", cmd_mdio_none, 1, 0),
	SHELL_SUBCMD_SET_END);

SHELL_CMD_REGISTER(mdio, &sub_mdio_cmds, "MDIO bus debug tools", NULL);

#endif /* DT_NODE_HAS_STATUS(DT_NODELABEL(mdio), okay) */
```
