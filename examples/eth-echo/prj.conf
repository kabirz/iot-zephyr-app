## CMakeLists.txt
```
cmake_minimum_required(VERSION 3.20.0)
find_package(Zephyr REQUIRED HINTS $ENV{ZEPHYR_BASE})

project(eth_echo)

target_sources(app PRIVATE main.c src/bwtest.c src/bench_shell.c src/usb_dump.c)
```

## prj.conf
```kconfig
CONFIG_LOG=y

CONFIG_NETWORKING=y
CONFIG_NET_IPV4=y
CONFIG_NET_IPV6=n
CONFIG_NET_UDP=y
CONFIG_NET_TCP=y
CONFIG_NET_L2_ETHERNET=y
CONFIG_NET_SOCKETS=y

# static IPv4 setup for the direct cable to the development machine
CONFIG_NET_CONFIG_SETTINGS=y
CONFIG_NET_CONFIG_MY_IPV4_ADDR="192.168.12.200"
CONFIG_NET_CONFIG_MY_IPV4_NETMASK="255.255.255.0"
CONFIG_NET_CONFIG_MY_IPV4_GW=""

CONFIG_NET_SHELL=y

CONFIG_NET_STATISTICS=y

# network stack buffers: the 128-byte default data chunks let only ~3 TCP
# segments be in flight (RX pool = 36 bufs), which stalls any transfer
# larger than ~4 KB
CONFIG_NET_BUF_DATA_SIZE=1536
CONFIG_NET_BUF_RX_COUNT=192
CONFIG_NET_BUF_TX_COUNT=192
CONFIG_NET_PKT_RX_COUNT=48
CONFIG_NET_PKT_TX_COUNT=48

CONFIG_ENTROPY_GENERATOR=y

CONFIG_MAIN_STACK_SIZE=4096
CONFIG_NET_TC_THREAD_PREEMPTIVE=y
CONFIG_ETH_GD32_RX_THREAD_PRIO=4

# bring-up diagnosis: runtime DMA interrupt control over the shell
CONFIG_ETH_GD32_IRQ_TEST=y
CONFIG_ETH_GD32_RX_DESC_NUM=32
CONFIG_CACHE_MANAGEMENT=y
```

## src/bench_shell.c
```c
/*
 * UDP performance benchmark shell commands, ported from
 * apps/applications/n2e-gw/src/net_shell.c (gw bench tx/rx/bidir).
 *
 *   bench tx [count=100] [size=64] [ip=192.168.12.100] [port=19602]
 *       board -> host one-way TX throughput (seq in payload for
 *       host-side loss accounting)
 *   bench rx [port=19601] [duration_ms=5000]
 *       host floods the board, board counts packets/bytes
 *   bench bidir [duration_ms=5000] [size=64] [rx_port=19601]
 *       one socket sending to host and draining its own RX
 *
 * Differences from the original: zsock_* API and a default host address
 * (this example has no persisted settings); the benchmark ports stay
 * 19601/19602 to keep away from the TCP test endpoints (4242/9900).
 */

#include <zephyr/kernel.h>
#include <zephyr/net/socket.h>
#include <zephyr/shell/shell.h>
#include <zephyr/sys/byteorder.h>
#include <zephyr/logging/log.h>
#include <stdlib.h>
#include <string.h>
#include <errno.h>

LOG_MODULE_REGISTER(bench, LOG_LEVEL_INF);

#define BENCH_HOST_IP_DEF	"192.168.12.100"
#define BENCH_TX_COUNT_DEF	100
#define BENCH_TX_COUNT_MAX	1000
#define BENCH_TX_SIZE_DEF	64
#define BENCH_TX_SIZE_MAX	1024
#define BENCH_RX_DUR_DEF	5000
#define BENCH_RX_DUR_MAX	30000
#define BENCH_PORT_TX_DEF	19602
#define BENCH_PORT_RX_DEF	19601

static uint8_t bench_buf[BENCH_TX_SIZE_MAX];

static int cmd_bench_tx(const struct shell *ctx, size_t argc, char **argv)
{
	int count = BENCH_TX_COUNT_DEF;
	int size = BENCH_TX_SIZE_DEF;
	const char *ip = BENCH_HOST_IP_DEF;
	int port = BENCH_PORT_TX_DEF;

	if (argc >= 2) {
		count = (int)strtol(argv[1], NULL, 10);
		count = CLAMP(count, 1, BENCH_TX_COUNT_MAX);
	}
	if (argc >= 3) {
		size = (int)strtol(argv[2], NULL, 10);
		size = CLAMP(size, 1, BENCH_TX_SIZE_MAX);
	}
	if (argc >= 4) {
		ip = argv[3];
	}
	if (argc >= 5) {
		port = (int)strtol(argv[4], NULL, 10);
		if (port < 1 || port > 65535) {
			shell_error(ctx, "invalid port: %s", argv[4]);
			return -EINVAL;
		}
	}

	int sock = zsock_socket(AF_INET, SOCK_DGRAM, IPPROTO_UDP);

	if (sock < 0) {
		shell_error(ctx, "socket create failed: %d", errno);
		return -EIO;
	}

	struct sockaddr_in dst = {
		.sin_family = AF_INET,
		.sin_port = htons(port),
	};

	if (zsock_inet_pton(AF_INET, ip, &dst.sin_addr) != 1) {
		shell_error(ctx, "invalid ip: %s", ip);
		zsock_close(sock);
		return -EINVAL;
	}

	memset(bench_buf, 0xAA, sizeof(bench_buf));
	shell_print(ctx, "TX bench: %d pkts x %d B -> %s:%d", count, size, ip, port);

	uint32_t t0 = k_uptime_get_32();
	int sent = 0;
	int fail = 0;

	for (int i = 0; i < count; i++) {
		sys_put_le32((uint32_t)i, bench_buf);
		int ret = zsock_sendto(sock, bench_buf, size, 0,
					(struct sockaddr *)&dst, sizeof(dst));
		if (ret < 0) {
			fail++;
			if (fail <= 3) {
				shell_warn(ctx, "  sendto failed @%d: errno %d",
					   i, errno);
			}
		} else {
			sent++;
		}
	}

	uint32_t elapsed = k_uptime_get_32() - t0;
	zsock_close(sock);

	uint32_t total_bytes = (uint32_t)sent * (uint32_t)size;

	shell_print(ctx, "done: %d sent, %d failed", sent, fail);
	shell_print(ctx, "data: %u B in %u ms", total_bytes, elapsed);
	if (elapsed > 0) {
		shell_print(ctx, "rate: %u pkt/s, %u B/s",
			    (uint32_t)sent * 1000U / elapsed,
			    total_bytes * 1000U / elapsed);
	}
	return 0;
}

static int cmd_bench_rx(const struct shell *ctx, size_t argc, char **argv)
{
	int port = BENCH_PORT_RX_DEF;
	int duration = BENCH_RX_DUR_DEF;

	if (argc >= 2) {
		port = (int)strtol(argv[1], NULL, 10);
		if (port < 1 || port > 65535) {
			shell_error(ctx, "invalid port: %s", argv[1]);
			return -EINVAL;
		}
	}
	if (argc >= 3) {
		duration = (int)strtol(argv[2], NULL, 10);
		duration = CLAMP(duration, 100, BENCH_RX_DUR_MAX);
	}

	int sock = zsock_socket(AF_INET, SOCK_DGRAM, IPPROTO_UDP);

	if (sock < 0) {
		shell_error(ctx, "socket create failed: %d", errno);
		return -EIO;
	}

	struct sockaddr_in local = {
		.sin_family = AF_INET,
		.sin_port = htons(port),
	};

	if (zsock_bind(sock, (struct sockaddr *)&local, sizeof(local)) < 0) {
		shell_error(ctx, "bind :%d failed: %d", port, errno);
		zsock_close(sock);
		return -EIO;
	}

	shell_print(ctx, "RX bench: listening on :%d for %d ms", port, duration);
	shell_print(ctx, "(send UDP to 192.168.12.200:%d from host)", port);

	uint32_t t0 = k_uptime_get_32();
	uint32_t deadline = t0 + (uint32_t)duration;
	uint32_t last_print = t0;
	uint32_t pkt_count = 0;
	uint32_t byte_count = 0;
	uint32_t max_gap_ms = 0;

	while (k_uptime_get_32() < deadline) {
		ssize_t n = zsock_recvfrom(sock, bench_buf, sizeof(bench_buf),
					   ZSOCK_MSG_DONTWAIT, NULL, NULL);
		if (n > 0) {
			pkt_count++;
			byte_count += (uint32_t)n;
		} else {
			uint32_t s0 = k_uptime_get_32();

			k_msleep(1);
			max_gap_ms = MAX(max_gap_ms, k_uptime_get_32() - s0);
		}
		uint32_t now = k_uptime_get_32();

		if (now - last_print >= 1000) {
			shell_print(ctx, "  ... %u pkts, %u B", pkt_count, byte_count);
			last_print = now;
		}
	}

	uint32_t elapsed = k_uptime_get_32() - t0;
	zsock_close(sock);

	shell_print(ctx, "done: %u pkts, %u B in %u ms", pkt_count, byte_count, elapsed);
	if (elapsed > 0 && pkt_count > 0) {
		shell_print(ctx, "rate: %u pkt/s, %u B/s",
			    pkt_count * 1000U / elapsed,
			    byte_count * 1000U / elapsed);
	}
	shell_print(ctx, "longest empty poll: %u ms", max_gap_ms);
	return 0;
}

static int cmd_bench_bidir(const struct shell *ctx, size_t argc, char **argv)
{
	int duration = BENCH_RX_DUR_DEF;
	int size = BENCH_TX_SIZE_DEF;
	int rx_port = BENCH_PORT_RX_DEF;

	if (argc >= 2) {
		duration = (int)strtol(argv[1], NULL, 10);
		duration = CLAMP(duration, 100, BENCH_RX_DUR_MAX);
	}
	if (argc >= 3) {
		size = (int)strtol(argv[2], NULL, 10);
		size = CLAMP(size, 1, BENCH_TX_SIZE_MAX);
	}
	if (argc >= 4) {
		rx_port = (int)strtol(argv[3], NULL, 10);
		if (rx_port < 1 || rx_port > 65535) {
			shell_error(ctx, "invalid port: %s", argv[3]);
			return -EINVAL;
		}
	}

	int sock = zsock_socket(AF_INET, SOCK_DGRAM, IPPROTO_UDP);

	if (sock < 0) {
		shell_error(ctx, "socket create failed: %d", errno);
		return -EIO;
	}

	struct sockaddr_in local = {
		.sin_family = AF_INET,
		.sin_port = htons(rx_port),
	};

	if (zsock_bind(sock, (struct sockaddr *)&local, sizeof(local)) < 0) {
		shell_error(ctx, "bind :%d failed: %d", rx_port, errno);
		zsock_close(sock);
		return -EIO;
	}

	struct sockaddr_in dst = {
		.sin_family = AF_INET,
		.sin_port = htons(BENCH_PORT_TX_DEF),
	};

	if (zsock_inet_pton(AF_INET, BENCH_HOST_IP_DEF, &dst.sin_addr) != 1) {
		zsock_close(sock);
		return -EINVAL;
	}

	memset(bench_buf, 0xAA, sizeof(bench_buf));
	shell_print(ctx, "BIDIR: TX->%s:%d  RX on :%d  %d ms  %d B/pkt",
		    BENCH_HOST_IP_DEF, BENCH_PORT_TX_DEF, rx_port, duration, size);

	uint32_t t0 = k_uptime_get_32();
	uint32_t deadline = t0 + (uint32_t)duration;
	uint32_t last_print = t0;
	uint32_t tx_sent = 0, tx_fail = 0;
	uint32_t rx_pkts = 0, rx_bytes = 0;
	uint32_t seq = 0;

	while (k_uptime_get_32() < deadline) {
		sys_put_le32(seq++, bench_buf);
		int ret = zsock_sendto(sock, bench_buf, size, 0,
					(struct sockaddr *)&dst, sizeof(dst));
		if (ret < 0) {
			tx_fail++;
		} else {
			tx_sent++;
		}

		for (int drain = 0;
		     drain < 32 && k_uptime_get_32() < deadline;
		     drain++) {
			ssize_t n = zsock_recvfrom(sock, bench_buf,
						   sizeof(bench_buf),
						   ZSOCK_MSG_DONTWAIT, NULL, NULL);

			if (n <= 0) {
				break;
			}
			rx_pkts++;
			rx_bytes += (uint32_t)n;
		}

		uint32_t now = k_uptime_get_32();

		if (now - last_print >= 1000) {
			shell_print(ctx, "  ... TX %u, RX %u pkts", tx_sent, rx_pkts);
			last_print = now;
		}
	}

	uint32_t elapsed = k_uptime_get_32() - t0;
	zsock_close(sock);

	uint32_t tx_bytes = tx_sent * (uint32_t)size;

	shell_print(ctx, "TX: %u sent, %u failed, %u B", tx_sent, tx_fail, tx_bytes);
	shell_print(ctx, "RX: %u pkts, %u B", rx_pkts, rx_bytes);
	shell_print(ctx, "time: %u ms", elapsed);
	if (elapsed > 0) {
		shell_print(ctx, "TX rate: %u pkt/s, %u B/s",
			    tx_sent * 1000U / elapsed, tx_bytes * 1000U / elapsed);
		if (rx_pkts > 0) {
			shell_print(ctx, "RX rate: %u pkt/s, %u B/s",
				    rx_pkts * 1000U / elapsed,
				    rx_bytes * 1000U / elapsed);
		}
	}
	return 0;
}

SHELL_STATIC_SUBCMD_SET_CREATE(
	sub_bench_cmds,
	SHELL_CMD_ARG(tx, NULL,
		      "bench tx [count=100] [size=64] [ip] [port=19602]",
		      cmd_bench_tx, 1, 4),
	SHELL_CMD_ARG(rx, NULL,
		      "bench rx [port=19601] [duration_ms=5000]",
		      cmd_bench_rx, 1, 2),
	SHELL_CMD_ARG(bidir, NULL,
		      "bench bidir [duration_ms=5000] [size=64] [rx_port=19601]",
		      cmd_bench_bidir, 1, 3),
	SHELL_SUBCMD_SET_END);

SHELL_CMD_REGISTER(bench, &sub_bench_cmds, "UDP performance benchmark", NULL);
```

## src/bwtest.c
```c
/*
 * Bandwidth test endpoint, ported from io-edge-hub's src/bwtest.c
 * (temporary product measurement code) to this board bring-up example.
 *
 *  - TCP server on port 9900
 *  - single connection; the first byte selects the mode:
 *      'R'  receive-only sink (device downlink / RX capacity)
 *      any  echo (bidirectional throughput)
 *  - run from a host with the scripts in scripts/ or any TCP client
 *
 * Differences from the original: zsock_* calls (this fork's example has
 * no POSIX socket names), TCP_NODELAY on the echo socket (the Zephyr
 * stack otherwise serialises the echo one ACK wait per segment) and
 * errno logging on send failure (ENOBUFS pool exhaustion is the
 * interesting case on this stack).
 */

#include <zephyr/kernel.h>
#include <zephyr/net/socket.h>
#include <zephyr/logging/log.h>

LOG_MODULE_REGISTER(bwtest, LOG_LEVEL_INF);

#define BW_PORT		9900
#define BW_BUF_SIZE	4096
#define BW_THREAD_PRIO	15

static void bw_echo_thread(void *p1, void *p2, void *p3)
{
	ARG_UNUSED(p1);
	ARG_UNUSED(p2);
	ARG_UNUSED(p3);

	int serv = zsock_socket(AF_INET, SOCK_STREAM, IPPROTO_TCP);

	if (serv < 0) {
		LOG_ERR("socket failed: %d", errno);
		return;
	}

	struct sockaddr_in addr = {
		.sin_family = AF_INET,
		.sin_addr.s_addr = htonl(INADDR_ANY),
		.sin_port = htons(BW_PORT),
	};

	if (zsock_bind(serv, (struct sockaddr *)&addr, sizeof(addr)) < 0 ||
	    zsock_listen(serv, 1) < 0) {
		LOG_ERR("bind/listen failed: %d", errno);
		zsock_close(serv);
		return;
	}

	LOG_INF("BW test echo server on port %d", BW_PORT);

	while (true) {
		int c = zsock_accept(serv, NULL, NULL);

		if (c < 0) {
			continue;
		}
		LOG_INF("BW test client connected");

		/* Mode: first byte 'R' = receive-only sink (device RX);
		 * anything else = echo (bidirectional). */
		uint8_t mode = 0;
		ssize_t first = zsock_recv(c, &mode, 1, 0);

		if (first != 1 || mode == 'R') {
			static uint8_t sink[BW_BUF_SIZE];
			ssize_t n;
			uint32_t total = 0U;
			uint32_t t0 = k_uptime_get_32();

			while ((n = zsock_recv(c, sink, sizeof(sink), 0)) > 0) {
				total += n;
			}
			LOG_INF("BW sink done: %u bytes in %u ms (%u KB/s)",
				total, k_uptime_get_32() - t0,
				(total / 1024U) /
					MAX(1U, (k_uptime_get_32() - t0) / 1000U));
			zsock_close(c);
			continue;
		}

		static uint8_t buf[BW_BUF_SIZE];
		int nodelay = 1;

		(void)zsock_setsockopt(c, IPPROTO_TCP, TCP_NODELAY,
				       &nodelay, sizeof(nodelay));

		ssize_t n;
		while ((n = zsock_recv(c, buf, sizeof(buf), 0)) > 0) {
			ssize_t off = 0;

			while (off < n) {
				ssize_t w = zsock_send(c, buf + off, n - off, 0);

				if (w < 0) {
					LOG_ERR("send failed: %d", errno);
					goto done;
				}
				off += w;
			}
		}
done:
		LOG_INF("BW test client done");
		zsock_close(c);
	}
}

K_THREAD_DEFINE(bw_test, 4096, bw_echo_thread, NULL, NULL, NULL,
		BW_THREAD_PRIO, 0, 0);
```

## src/usb_cdc_echo.c
```c
/*
 * USB CDC ACM echo endpoint.
 *
 * Enables the USB device stack and echoes everything received on the
 * CDC ACM data interface back to the host, so `lsusb` plus a simple
 * read/write loop measures end-to-end bring-up.  The UART shell stays
 * on USART0 for board-side debugging.  Modeled on the legacy
 * samples/subsys/usb/legacy/cdc_acm sample.
 */

#include <string.h>

#include <zephyr/device.h>
#include <zephyr/drivers/uart.h>
#include <zephyr/kernel.h>
#include <zephyr/logging/log.h>
#include <zephyr/sys/ring_buffer.h>
#include <zephyr/usb/usb_device.h>

LOG_MODULE_REGISTER(usb_cdc_echo, LOG_LEVEL_INF);

static const struct device *const cdc_dev =
	DEVICE_DT_GET(DT_NODELABEL(cdc_acm_uart0));

#define RING_BUF_SIZE 1024

static uint8_t ring_buffer[RING_BUF_SIZE];
static struct ring_buf ringbuf;
static bool rx_throttled;

static void interrupt_handler(const struct device *dev, void *user_data)
{
	ARG_UNUSED(user_data);

	while (uart_irq_update(dev) && uart_irq_is_pending(dev)) {
		if (!rx_throttled && uart_irq_rx_ready(dev)) {
			uint8_t buffer[64];
			int recv_len, rb_len;
			size_t len = MIN(ring_buf_space_get(&ringbuf),
					 sizeof(buffer));

			if (len == 0) {
				/* throttle: ring buffer full */
				uart_irq_rx_disable(dev);
				rx_throttled = true;
				continue;
			}

			recv_len = uart_fifo_read(dev, buffer, len);
			if (recv_len < 0) {
				LOG_ERR("Failed to read UART FIFO");
				recv_len = 0;
			}

			rb_len = ring_buf_put(&ringbuf, buffer, recv_len);
			if (rb_len < recv_len) {
				LOG_ERR("Drop %u bytes", recv_len - rb_len);
			}

			if (rb_len) {
				uart_irq_tx_enable(dev);
			}
		}

		if (uart_irq_tx_ready(dev)) {
			uint8_t buffer[64];
			int rb_len, send_len;

			rb_len = ring_buf_get(&ringbuf, buffer, sizeof(buffer));
			if (!rb_len) {
				uart_irq_tx_disable(dev);
				continue;
			}

			if (rx_throttled) {
				uart_irq_rx_enable(dev);
				rx_throttled = false;
			}

			send_len = uart_fifo_fill(dev, buffer, rb_len);
			if (send_len < rb_len) {
				LOG_ERR("Drop %d bytes", rb_len - send_len);
			}
		}
	}
}

static void usb_cdc_thread(void *p1, void *p2, void *p3)
{
	uint32_t dtr = 0U;
	int ret;

	ARG_UNUSED(p1);
	ARG_UNUSED(p2);
	ARG_UNUSED(p3);

	k_sleep(K_SECONDS(1));

	ring_buf_init(&ringbuf, sizeof(ring_buffer), ring_buffer);

	ret = usb_enable(NULL);
	if (ret) {
		LOG_ERR("usb_enable failed: %d", ret);
		return;
	}
	LOG_INF("USB device enabled");

	if (!device_is_ready(cdc_dev)) {
		LOG_ERR("CDC ACM device not ready");
		return;
	}

	/* host must open the port (DTR) before data flows */
	while (!dtr) {
		ret = uart_line_ctrl_get(cdc_dev, UART_LINE_CTRL_DTR, &dtr);
		if (ret) {
			LOG_ERR("Failed to get DTR line state: %d", ret);
		}
		k_sleep(K_MSEC(100));
	}
	LOG_INF("DTR set, host connected");

	/* optional: assert DCD/DSR to exercise the control endpoint */
	(void)uart_line_ctrl_set(cdc_dev, UART_LINE_CTRL_DCD, 1);
	(void)uart_line_ctrl_set(cdc_dev, UART_LINE_CTRL_DSR, 1);
	k_msleep(100);

	uart_irq_callback_set(cdc_dev, interrupt_handler);
	uart_irq_rx_enable(cdc_dev);

	while (true) {
		k_sleep(K_SECONDS(60));
	}
}

K_THREAD_DEFINE(usb_cdc_echo_thr, 2048, usb_cdc_thread, NULL, NULL, NULL,
		5, 0, 0);
```

## src/usb_dump.c
```c
/*
 * GD32H7xx USBHS register dump and bring-up rehearsal.
 *
 * Direct register access (no HAL): turns on the PMU 3.3V USB supply, the
 * IRC48M PHY reference clock and the USBHS0 bus gate, then dumps the DWC2
 * core identification and hardware configuration registers.  `gdusb fs`
 * selects the embedded FS PHY and runs a core soft reset to verify the
 * clocking path before the real driver integration.
 *
 * Memory map (vendor gd32h73x_75x.h): APB4 0x58000000 (PMU at +0x5800),
 * AHB1 0x40020000 (USBHS0 at +0x20000), AHB4 0x58020000 (RCU at +0x4400).
 */

#include <errno.h>
#include <stdint.h>
#include <stdlib.h>

#include <zephyr/kernel.h>
#include <zephyr/shell/shell.h>
#include <zephyr/sys/util.h>

#define RCU_BASE        0x58024400UL
#define RCU_AHB1EN      (*reg32(RCU_BASE, 0x30))
#define RCU_APB4EN      (*reg32(RCU_BASE, 0x4c))
#define RCU_ADDCTL0     (*reg32(RCU_BASE, 0xc0))
#define RCU_USBCLKCTL   (*reg32(RCU_BASE, 0xd4))

#define PMU_BASE        0x58005800UL
#define PMU_CTL2        (*reg32(PMU_BASE, 0x10))

#define USBHS0_BASE     0x40040000UL
#define USBHS1_BASE     0x40080000UL

/* DWC2 global register offsets (GigaDevice names: GUSBCS/GCCFG/GOTGCS) */
#define GOTGCTL_OFF     0x00
#define GUSBCS_OFF      0x0c
#define GRSTCTL_OFF     0x10
#define GCCFG_OFF       0x38
#define GSNPSID_OFF     0x40
#define GHWCFG1_OFF     0x44
#define GHWCFG2_OFF     0x48
#define GHWCFG3_OFF     0x4c
#define GHWCFG4_OFF     0x50

/* GRSTCTL */
#define GRSTCTL_CSFTRST BIT(0)
#define GRSTCTL_AHBIDLE BIT(31)

/* GUSBCS bit 6: embedded full-speed PHY select (GigaDevice EMBPHY_FS) */
#define GUSBCS_EMBPHY_FS BIT(6)

static inline volatile uint32_t *reg32(uintptr_t base, uintptr_t off)
{
	return (volatile uint32_t *)(base + off);
}

static int usb_clocks_up(const struct shell *sh)
{
	int t;

	/* PMU: enable the 3.3V USB supply regulator and its voltage
	 * detector, wait (bounded) for the supply-ready flag. */
	shell_print(sh, "[1] PMU regulator...");
	RCU_APB4EN |= BIT(4);              /* PMU bus clock */
	PMU_CTL2 |= (BIT(25) | BIT(24));   /* USBSEN + VUSB33DEN */
	for (t = 0; !(PMU_CTL2 & BIT(26)) && t < 100000; t++) {
		k_busy_wait(1);            /* USB33RF */
	}
	if (!(PMU_CTL2 & BIT(26))) {
		shell_print(sh, "  TIMEOUT: USB33RF never set, PMU_CTL2=0x%08x",
			    PMU_CTL2);
		return -ETIMEDOUT;
	}
	shell_print(sh, "  ready, PMU_CTL2=0x%08x", PMU_CTL2);

	/* 48MHz PHY reference from IRC48M */
	shell_print(sh, "[2] IRC48M...");
	RCU_ADDCTL0 |= BIT(16);            /* IRC48MEN */
	for (t = 0; !(RCU_ADDCTL0 & BIT(17)) && t < 100000; t++) {
		k_busy_wait(1);            /* IRC48MSTB */
	}
	if (!(RCU_ADDCTL0 & BIT(17))) {
		shell_print(sh, "  TIMEOUT: IRC48MSTB, ADDCTL0=0x%08x",
			    RCU_ADDCTL0);
		return -ETIMEDOUT;
	}
	RCU_USBCLKCTL = (RCU_USBCLKCTL & ~(3U << 5)) | (3U << 5);
	shell_print(sh, "  ready, USBCLKCTL=0x%08x", RCU_USBCLKCTL);

	/* AHB bus gate for USBHS0 */
	shell_print(sh, "[3] RCU AHB gate...");
	RCU_AHB1EN |= BIT(14);
	k_busy_wait(10);
	shell_print(sh, "  AHB1EN=0x%08x", RCU_AHB1EN);

	return 0;
}

static void dump_core(const struct shell *sh, uintptr_t base, const char *name)
{
	uint32_t g2 = *reg32(base, GHWCFG2_OFF);
	uint32_t g3 = *reg32(base, GHWCFG3_OFF);
	uint32_t g4 = *reg32(base, GHWCFG4_OFF);
	int i;

	shell_print(sh, "---- %s @ 0x%08x ----", name, base);
	shell_print(sh, "  GSNPSID=0x%08x GUSBCS=0x%08x GCCFG=0x%08x GOTGCTL=0x%08x",
		    *reg32(base, GSNPSID_OFF), *reg32(base, GUSBCS_OFF),
		    *reg32(base, GCCFG_OFF), *reg32(base, GOTGCTL_OFF));
	shell_print(sh, "  GHWCFG1=0x%08x GHWCFG2=0x%08x GHWCFG3=0x%08x GHWCFG4=0x%08x",
		    *reg32(base, GHWCFG1_OFF), g2, g3, g4);
	shell_print(sh, "  decoded: num_dev_eps=%u num_in_eps=%u ded_fifo=%u fifo_dwords=%u",
		    (g2 >> 10) & 0xF, (g4 >> 26) & 0xF, (g4 >> 25) & 1, g3 & 0xFFFF);

	/* raw sweep of the global register file so unlisted (SVD-gap)
	 * registers show up too */
	for (i = 0; i < 0x64; i += 16) {
		shell_print(sh,
			    "  0x%02x: %08x %08x %08x %08x",
			    i,
			    *reg32(base, i), *reg32(base, i + 4),
			    *reg32(base, i + 8), *reg32(base, i + 12));
	}
	/* device domain: DCFG@0x800 DCTL@0x804 DSTS@0x808 DAINT@0x818 */
	shell_print(sh, "  DCFG=0x%08x DCTL=0x%08x DSTS=0x%08x DAINT=0x%08x",
		    *reg32(base, 0x800), *reg32(base, 0x804),
		    *reg32(base, 0x808), *reg32(base, 0x818));
	shell_print(sh, "  DIEP0: ctl=0x%08x int=0x%08x tsiz=0x%08x",
		    *reg32(base, 0x900), *reg32(base, 0x908),
		    *reg32(base, 0x910));
}

static int cmd_gdusb_dump(const struct shell *sh, size_t argc, char **argv)
{
	int idx = (argc > 1) ? atoi(argv[1]) : 0;
	int ret;

	if (idx == 1) {
		/* deliberately risky: USBHS1 may not be bonded on LQFP144,
		 * an unmapped AHB read faults the kernel */
		RCU_AHB1EN |= BIT(29);
		k_busy_wait(10);
		dump_core(sh, USBHS1_BASE, "USBHS1");
		return 0;
	}

	ret = usb_clocks_up(sh);
	if (ret) {
		return ret;
	}

	dump_core(sh, USBHS0_BASE, "USBHS0");
	shell_print(sh, "  done.");

	return 0;
}

static int cmd_gdusb_fs(const struct shell *sh, size_t argc, char **argv)
{
	ARG_UNUSED(argc);
	ARG_UNUSED(argv);

	uintptr_t base = USBHS0_BASE;
	volatile uint32_t *grstctl = reg32(base, GRSTCTL_OFF);
	int t, ret;

	ret = usb_clocks_up(sh);
	if (ret) {
		return ret;
	}

	shell_print(sh, "[4] FS PHY select...");
	*reg32(base, GUSBCS_OFF) |= GUSBCS_EMBPHY_FS;
	k_busy_wait(10);

	if (!(*grstctl & GRSTCTL_AHBIDLE)) {
		shell_print(sh, "  AHB idle never set: GRSTCTL=0x%08x",
			    *grstctl);
		return -EIO;
	}

	shell_print(sh, "[5] core soft reset...");
	*grstctl |= GRSTCTL_CSFTRST;
	for (t = 0; (*grstctl & GRSTCTL_CSFTRST) && t < 100000; t++) {
		k_busy_wait(1);
	}
	if (*grstctl & GRSTCTL_CSFTRST) {
		shell_print(sh, "  TIMEOUT: CSFTRST, GRSTCTL=0x%08x",
			    *grstctl);
		return -ETIMEDOUT;
	}
	k_busy_wait(100);

	shell_print(sh, "  OK: GUSBCS=0x%08x GRSTCTL=0x%08x",
		    *reg32(base, GUSBCS_OFF), *grstctl);

	return 0;
}

static int cmd_gdusb_pwron(const struct shell *sh, size_t argc, char **argv)
{
	ARG_UNUSED(argc);
	ARG_UNUSED(argv);

	int ret;

	ret = usb_clocks_up(sh);
	if (ret) {
		return ret;
	}

	/* power the FS transceiver, let it settle, then re-dump: the
	 * ID/config registers live in the PHY clock domain */
	shell_print(sh, "[4] GCCFG.PWRON...");
	*reg32(USBHS0_BASE, GCCFG_OFF) |= BIT(16);
	k_msleep(20);

	dump_core(sh, USBHS0_BASE, "USBHS0 (PHY powered)");

	return 0;
}

static int cmd_gdusb_dev(const struct shell *sh, size_t argc, char **argv)
{
	ARG_UNUSED(argc);
	ARG_UNUSED(argv);

	volatile uint32_t *dcfg = reg32(USBHS0_BASE, 0x800);
	volatile uint32_t *dctl = reg32(USBHS0_BASE, 0x804);

	/* probe: do writes into the device-clock-domain register file
	 * stick?  DCFG@0x800, DCTL@0x804 */
	shell_print(sh, "before: DCFG=0x%08x DCTL=0x%08x", *dcfg, *dctl);
	*dcfg = 0x12345678;
	*dctl = 0x55aa55aa;
	k_busy_wait(10);
	shell_print(sh, "after write: DCFG=0x%08x DCTL=0x%08x", *dcfg, *dctl);
	*dcfg = 0;
	*dctl = 0;
	k_busy_wait(10);
	shell_print(sh, "after clear: DCFG=0x%08x DCTL=0x%08x", *dcfg, *dctl);

	return 0;
}

static int cmd_gdusb_connect(const struct shell *sh, size_t argc, char **argv)
{
	ARG_UNUSED(argc);
	ARG_UNUSED(argv);

	volatile uint32_t *dctl = reg32(USBHS0_BASE, 0x804);
	int arg = (argc > 1) ? atoi(argv[1]) : 1;

	/* set (arg 1) or clear (arg 0) SFTDISCON (bit 1) manually */
	if (arg) {
		*dctl |= BIT(1);
	} else {
		*dctl &= ~BIT(1);
	}
	k_busy_wait(10);
	shell_print(sh, "DCTL=0x%08x", *dctl);

	return 0;
}

SHELL_STATIC_SUBCMD_SET_CREATE(gdusb_cmds,
	SHELL_CMD(dump, NULL, "dump USBHS0 DWC2 core regs (arg: 1 = USBHS1, may fault)",
		  cmd_gdusb_dump),
	SHELL_CMD(pwron, NULL, "power FS transceiver + dump", cmd_gdusb_pwron),
	SHELL_CMD(fs, NULL, "select embedded FS PHY + core soft reset (USBHS0)",
		  cmd_gdusb_fs),
	SHELL_CMD(dev, NULL, "probe device-domain register writes", cmd_gdusb_dev),
	SHELL_CMD(connect, NULL, "set/clear SFTDISCON (arg: 0 = connect)",
		  cmd_gdusb_connect),
	SHELL_SUBCMD_SET_END);

SHELL_CMD_REGISTER(gdusb, &gdusb_cmds, "GD32 USBHS debug", NULL);
```
