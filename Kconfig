## boards/laser_f103ret7/Kconfig.laser_f103ret7
```kconfig
# Copyright (c) 2020 WuhanStudio
# SPDX-License-Identifier: Apache-2.0

config BOARD_LASER_F103RET7
	select SOC_STM32F103XE
```

## boards/laser_f103ret7/board.yml
```yaml
board:
  name: laser_f103ret7
  full_name: laser f103ret7
  vendor: st
  socs:
    - name: stm32f103xe
```

## boards/nrf24_f103rct6/board.yml
```yaml
board:
  name: nrf24_f103rct6
  full_name: nrf24 f103rct6
  vendor: st
  socs:
    - name: stm32f103xe
```

## boards/nrf24_f103rct6/nrf24_f103rct6_defconfig
```kconfig
# SPDX-License-Identifier: Apache-2.0

# enable uart driver
CONFIG_SERIAL=y
# enable console
CONFIG_CONSOLE=y
CONFIG_UART_CONSOLE=y

# enable GPIO
CONFIG_GPIO=y

# Enable flash
CONFIG_FLASH=y
CONFIG_SPI_NOR_SFDP_MINIMAL=n
CONFIG_SPI_NOR_FLASH_LAYOUT_PAGE_SIZE=4096

# enable flash map
CONFIG_FLASH_MAP=y
```

## dts/bindings/nordic,nrf24l01p.yaml
```yaml
description: Nordic nRF24L01+ 2.4GHz radio transceiver

compatible: "nordic,nrf24l01p"

include: [spi-device.yaml]

properties:
  ce-gpios:
    type: phandle-array
    required: true
    description: Chip Enable control GPIO.
  irq-gpios:
    type: phandle-array
    required: true
    description: IRQ output GPIO (active-low, falling edge).
  power-gpios:
    type: phandle-array
    required: false
    description: Optional power-enable GPIO for the module regulator/switch.
      When present, the driver powers the chip on during init (after a POR
      stabilization delay) and exposes nrf24_power_enable() for sleep/wake.
  channel:
    type: int
    default: 76
    description: RF channel (0-125, 2400+channel MHz). Range enforced in driver.
  data-rate:
    type: string
    default: "1m"
    enum: ["250k", "1m", "2m"]
  tx-power:
    type: string
    default: "0dbm"
    enum: ["-18dbm", "-12dbm", "-6dbm", "0dbm"]
  address-width:
    type: int
    default: 5
    enum: [3, 4, 5]
  payload-mode:
    type: string
    default: "dynamic"
    enum: ["dynamic", "fixed"]
  rx-payload-width:
    type: int
    default: 32
    description: Payload length when payload-mode = "fixed" (0-32, enforced in driver).
  crc-mode:
    type: string
    default: "2-byte"
    enum: ["1-byte", "2-byte"]
  ard-us:
    type: int
    default: 4000
  arc:
    type: int
    default: 15
    description: Auto retransmit count (0-15, enforced in driver).
  tx-address:
    type: uint8-array
    default: [0xE7, 0xE7, 0xE7, 0xE7, 0xE7]
```
